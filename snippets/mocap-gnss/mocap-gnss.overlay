/* SPDX-License-Identifier: Apache-2.0 */

/*
 * Take the gnss topic from an injected fix instead of the onboard receiver:
 * motion capture or a ground station supplies it over the telemetry radio.
 *
 * Disabling the node deselects RDD2_GNSS_SOURCE_ONBOARD, so the UBX reader in
 * subsys/gnss_source is not compiled at all and lpuart2 stays free. That
 * also makes lpuart2 scannable with `zros_serial scan`, which is the easy way
 * to find what serial rate the receiver is actually running at before
 * switching back to the onboard default.
 */

&gnss0 {
	status = "disabled";
};

/ {
	aliases {
		/*
		 * With the receiver gone lpuart2 has no owner, so it becomes a
		 * legal scan target. This is how you find what serial rate the
		 * receiver actually runs at before switching back to onboard.
		 */
		zros-scan3 = &lpuart2;
	};
};
