## subsys/log_sdcard/Kconfig
```kconfig
menuconfig RDD2_LOG_SDCARD
	bool "RDD2 self-describing SD-card logger"
	default y
	depends on ZROS
	select FILE_SYSTEM
	select FILE_SYSTEM_LIB_LINK
	select FAT_FILESYSTEM_ELM
	select DISK_DRIVERS
	help
	  Write length-delimited synapse.log.LogRecord FlatBuffers to /SD:.
	  The logger writes schema records with embedded BFBS data before topic
	  frames so logs can be decoded without a matching source tree.

if RDD2_LOG_SDCARD

config RDD2_LOG_SDCARD_AUTOSTART
	bool "Start the SD-card logger at boot"
	default n

config RDD2_LOG_SDCARD_STACK_SIZE
	int "SD-card logger stack size"
	default 8192

config RDD2_LOG_SDCARD_PRIORITY
	int "SD-card logger thread priority"
	default 8

config RDD2_LOG_SDCARD_TOPIC_RATE_HZ
	int "Per-topic logger rate limit in Hz"
	default 100

config RDD2_LOG_SDCARD_PATH
	string "SD-card mount point"
	default "/SD:"

config RDD2_LOG_SDCARD_LOG_MOCAP
	bool "Log raw mocap frame payloads"
	default y
	depends on ZENOH_PICO_SHELL
	help
	  Log the raw synapse.topic.MocapFrame FlatBuffer received from Zenoh.
	  This preserves rigid-body poses and any other mocap content present in
	  that frame.

module = RDD2_LOG_SDCARD
module-str = rdd2_log_sdcard
source "subsys/logging/Kconfig.template.log_config"

endif
```

## subsys/sitl/Kconfig
```kconfig
config RDD2_SITL
	bool "Enable native_sim software-in-the-loop support"
	depends on BOARD_NATIVE_SIM
	default y
	help
	  Enable native_sim transport and shared FlatBuffer staging used by the
	  fake RC, IMU, and DSHOT device adapters.

if RDD2_SITL

choice RDD2_SITL_TRANSPORT
	prompt "SITL transport"
	default RDD2_SITL_TRANSPORT_UDP
	help
	  Select how native_sim exchanges SITL FlatBuffer payloads with the host
	  simulator.

config RDD2_SITL_TRANSPORT_UDP
	bool "UDP sockets"
	help
	  Use fixed UDP ports for the low-latency simulator loop.

config RDD2_SITL_TRANSPORT_ZENOH
	bool "Zenoh"
	select ZENOH_PICO
	select ZENOH_PICO_MULTI_THREAD
	select ZENOH_PICO_PUBLICATION
	select ZENOH_PICO_SUBSCRIPTION
	select ZENOH_PICO_SCOUTING
	select ZENOH_PICO_LINK_UDP_MULTICAST
	select ZENOH_PICO_LINK_UDP_UNICAST
	help
	  Use zenoh key expressions for SITL input, flight state, and motor
	  output FlatBuffer payloads.

endchoice

config RDD2_SITL_HOST
	string "SITL host IPv4 address"
	depends on RDD2_SITL_TRANSPORT_UDP
	default "127.0.0.1"
	help
	  IPv4 address of the host process that receives outbound SITL topic
	  datagrams.

config RDD2_SITL_RX_PORT
	int "SITL input UDP port"
	depends on RDD2_SITL_TRANSPORT_UDP
	range 1 65535
	default 4242
	help
	  UDP port on which native_sim receives FlatBuffer SimInput datagrams.

config RDD2_SITL_TX_FLIGHT_SNAPSHOT_PORT
	int "SITL flight state UDP port"
	depends on RDD2_SITL_TRANSPORT_UDP
	range 1 65535
	default 4243
	help
	  UDP port to which native_sim publishes outbound flight-state blobs
	  encoded as FlightSnapshot.

config RDD2_SITL_TX_MOTOR_OUTPUT_PORT
	int "SITL motor output UDP port"
	depends on RDD2_SITL_TRANSPORT_UDP
	range 1 65535
	default 4244
	help
	  UDP port to which native_sim publishes MotorOutput blobs.

config RDD2_SITL_ZENOH_MODE
	string "SITL zenoh mode"
	depends on RDD2_SITL_TRANSPORT_ZENOH
	default "client"
	help
	  Zenoh session mode. Use "client" to connect to a router or "peer" to
	  listen directly on a UDP locator.

config RDD2_SITL_ZENOH_LOCATOR
	string "SITL zenoh connect/listen locator"
	depends on RDD2_SITL_TRANSPORT_ZENOH
	default "udp/127.0.0.1:7447"
	help
	  Locator passed to zenoh-pico. In client mode this is the router
	  connect locator; in peer mode this is the local listen locator.

config RDD2_SITL_ZENOH_INPUT_KEYEXPR
	string "SITL zenoh input key expression"
	depends on RDD2_SITL_TRANSPORT_ZENOH
	default "rdd2/sitl/input"
	help
	  Key expression carrying SimInput FlatBuffer payloads into native_sim.

config RDD2_SITL_ZENOH_FLIGHT_STATE_KEYEXPR
	string "SITL zenoh flight state key expression"
	depends on RDD2_SITL_TRANSPORT_ZENOH
	default "rdd2/sitl/flight_state"
	help
	  Key expression used to publish FlightSnapshot FlatBuffer payloads.

config RDD2_SITL_ZENOH_MOTOR_OUTPUT_KEYEXPR
	string "SITL zenoh motor output key expression"
	depends on RDD2_SITL_TRANSPORT_ZENOH
	default "rdd2/sitl/motor_output"
	help
	  Key expression used to publish MotorOutput FlatBuffer payloads.

config RDD2_SITL_ZENOH_RETRY_MS
	int "SITL zenoh reconnect period in milliseconds"
	depends on RDD2_SITL_TRANSPORT_ZENOH
	range 100 10000
	default 1000
	help
	  Delay between zenoh connect or reconnect attempts.

config RDD2_SITL_THREAD_PRIORITY
	int "SITL transport thread priority"
	default 5
	help
	  Low-priority thread that handles host SITL transport work.

config RDD2_SITL_THREAD_STACK_SIZE
	int "SITL transport thread stack size"
	default 4096
	help
	  Stack size for the low-priority SITL transport thread.

endif
```
