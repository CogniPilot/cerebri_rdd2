## subsys/flight_log/Kconfig
```kconfig
config RDD2_FLIGHT_LOG
	bool "SD flight logger"
	default n
	select DISK_ACCESS
	select DISK_DRIVERS
	select DISK_DRIVER_SDMMC
	select SDHC
	select IMX_USDHC
	select FILE_SYSTEM
	select FAT_FILESYSTEM_ELM
	select FS_FATFS_LFN
	# Compiles in the FatFs native extension calls, including f_expand, which
	# the session layer uses to reserve a contiguous per-session extent so
	# streaming writes touch no FAT allocation metadata.
	select FS_FATFS_EXTRA_NATIVE_API
	# Compiles in the native f_mkfs so a blank card can be given the cluster
	# size and data-area alignment the logger wants, instead of whatever a
	# host tool left behind.
	select FS_FATFS_MKFS
	select HWINFO
	select SYNAPSE_FBS_MCAP
	select RING_BUFFER
	select RING_BUFFER_LARGE
	select MCUMGR_GRP_FS if MCUMGR
	select MCUMGR_MGMT_NOTIFICATION_HOOKS if MCUMGR
	select MCUMGR_GRP_FS_FILE_ACCESS_HOOK if MCUMGR
	help
	  Record the internal ZROS flight bus to the microSD card as a
	  self-contained synapse/1 MCAP file, one session file per boot. The
	  card is mounted on first use with an existing FAT volume: an absent or
	  unformatted card is a clean no-op and never blocks bring-up. Selecting
	  this pulls in the usdhc block device, the FAT filesystem, and the
	  card-detect disk driver for the mr_vmu_tropic microSD slot.

if RDD2_FLIGHT_LOG

config RDD2_FLIGHT_LOG_SD_SHELL
	bool "Bench sd shell"
	depends on SHELL
	default y
	help
	  Register the `sd` shell command group (mount, unmount, ls, info) for
	  bench validation of the microSD card independent of the logger threads.

config RDD2_FLIGHT_LOG_BLOCK_BYTES
	int "Storage block size in bytes"
	default 4096
	help
	  Sector-aligned staging block. The sink accumulates writer output into a
	  buffer of this size and flushes whole blocks to FatFs, so short MCAP
	  records do not each become an unaligned card write. Must be a multiple
	  of the card sector size (512).

config RDD2_FLIGHT_LOG_RING_BYTES
	int "Capture ring buffer size in bytes"
	default 131072
	help
	  Bounded single-producer single-consumer staging ring between the
	  capture thread and the writer thread. When it is full the capture
	  thread drops the frame and counts it rather than blocking the bus.

	  Sizing: at the measured 257 KB/s offered load this 131072-byte ring
	  holds about 510 ms of frames (131072 / 257000). The writer drains it
	  every loop but blocks for tens of milliseconds during an f_sync on
	  FAT, so the ring must cover the flush cadence plus one such spike. At
	  the 400 ms flush period that leaves about 110 ms of headroom. The
	  previous 65536-byte ring held only about 255 ms, level with the old
	  250 ms cadence, so every f_sync spike overflowed it (ring high water
	  pinned full, steady ~150 dropped frames/s).

config RDD2_FLIGHT_LOG_ROTATE_BYTES
	int "Session file rotation size in bytes"
	default 268435456
	help
	  Both the per-session extent reservation and the size at which the
	  current session file is closed and the next index opened: a session is
	  handed its whole reservation up front and rotates when it has filled it.

	  The default is 256 MiB, which is also the size of one standing
	  reservation in the pool below. FAT32 caps a single file at 4 GiB minus
	  one byte and the FatFs file size is 32-bit, so nothing above 4095 MiB is
	  representable. The value must be a multiple of the 32 KiB cluster size so
	  a reservation covers whole clusters.

	  The card must have room for the streaming session plus at least one
	  standing reservation for rotation to stay burst-free. When it does not,
	  the reservation build gives up and rotation falls back to reserving
	  inline. At the 8 MiB growth step and the 400 ms flush cadence one 256 MiB
	  reservation takes 32 steps, about 13 seconds.

config RDD2_FLIGHT_LOG_RESERVE_BYTES
	int "Standing reservation pool size in bytes"
	default 4294967296
	help
	  Total size of the standing reservations the writer tries to keep on the
	  card. The pool holds RDD2_FLIGHT_LOG_RESERVE_BYTES divided by
	  RDD2_FLIGHT_LOG_ROTATE_BYTES reservations (at least one), so the default
	  4 GiB over the 256 MiB rotation size is 16 slots, reserve00.pre through
	  reserve15.pre. A card with less free space than that simply keeps as many
	  as fit: the build of the next one stops at the free-space gate and the
	  pool stands at whatever it reached.

	  Each is a full-size pre-built and pre-erased extent, so every rotation
	  and every boot renames one in instead of reserving inline. The writer
	  refills the pool in the background, one reservation at a time, whenever
	  the count is below the pool size and free space allows.

config RDD2_FLIGHT_LOG_PREALLOC_STEP_BYTES
	int "Reservation growth step in bytes"
	default 8388608
	help
	  Amount by which the writer grows the reservation it is building on each
	  flush cycle. While a session streams, the writer incrementally builds one
	  standing reservation (reserveNN.pre) up to the rotation size so the next
	  session's extent is fully allocated before it is needed, keeping the
	  f_expand burst out of the mid-flight rotation path. Growth is one step per
	  flush cycle, taken in the writer thread between drain batches under the
	  card lock, so each step blocks draining only briefly (a few small FAT
	  writes) and a whole reservation amortizes over seconds of a session.

	  The default is 8 MiB. At the 256 MiB rotation size that is 32 steps, and
	  at the 400 ms flush cadence one reservation completes in about 13
	  seconds, so the full 16-slot pool builds in a few minutes, far ahead of a
	  size-triggered rotation (tens of minutes of streaming at the measured
	  flight data rate). Larger steps finish sooner but lengthen each lock hold;
	  smaller steps shorten the hold but spread the build over more cycles. Must
	  be a multiple of the card cluster size for a clean per-step cluster-chain
	  extension.

config RDD2_FLIGHT_LOG_EAGER_ROTATE
	bool "Rotate immediately at the byte threshold"
	default n
	help
	  Trigger the size-based session rotation as soon as the streamed byte
	  count reaches the rotation size, without waiting for a standing
	  reservation and a nearly empty ring. This is the older eager behavior
	  whose mid-flight extent reservation stalled the writer long enough to
	  overflow the capture ring, and it is retained only for regression
	  comparison against the deferred rotation path.

config RDD2_FLIGHT_LOG_TIMEREF_PERIOD_MS
	int "TimeReference emission period in milliseconds"
	default 100

config RDD2_FLIGHT_LOG_FLUSH_PERIOD_MS
	int "Flush and sync period in milliseconds"
	default 400
	help
	  Upper bound on how long written records sit unsynced. Each flush writes
	  the whole sectors of the block remainder and syncs, holding back the
	  sub-sector tail so the file offset stays 512-aligned, so a power loss
	  costs at most this window of data (about 400 ms, up from the previous
	  250 ms) plus the at most 511 bytes held back for that alignment.

	  The ring must cover this cadence plus one sync latency spike. With
	  the 131072-byte ring holding about 510 ms of frames at 257 KB/s, a
	  400 ms cadence leaves about 110 ms of margin to absorb the tens of
	  milliseconds an f_sync can block on FAT. A 500 ms cadence was rejected:
	  it would leave only about 10 ms of margin, thinner than a single spike,
	  so the ring would keep overflowing. 400 ms both keeps that margin and
	  bounds power-cut loss tighter than 500 ms would.

config RDD2_FLIGHT_LOG_RETRY_MS
	int "Mount retry period in milliseconds"
	default 2000
	help
	  Low-rate retry cadence while no card is present, so a card inserted
	  after boot starts a session without a reboot.

config RDD2_FLIGHT_LOG_WRITER_PRIORITY
	int "Writer thread priority"
	default 8
	help
	  Runs below every flight and wire thread (priorities 2 through 7) so
	  card latency never disturbs the flight loop, but above the background
	  floor-drain threads at priority 14. Priority 8 (raised from 10) gives
	  the writer enough scheduling headroom to keep draining the ring against
	  the drop backlog without ever contending with the control domain.

config RDD2_FLIGHT_LOG_FRONT_PRIORITY
	int "Capture thread priority"
	default 4
	help
	  Sits between navigation (3) and planning (5) so decimated sample copies
	  never preempt the estimator or the rate loop.

config RDD2_FLIGHT_LOG_WRITER_STACK_SIZE
	int "Writer thread stack size"
	default 4096

config RDD2_FLIGHT_LOG_FRONT_STACK_SIZE
	int "Capture thread stack size"
	default 4096

config RDD2_FLIGHT_LOG_ARM_GATED_HIGH_RATE
	bool "Gate the IMU and PWM tiers on armed"
	default n
	help
	  When set, the high-rate inertial and motor-output tiers are recorded
	  only while the vehicle is armed. The lower-rate state, command, and
	  sensor tiers are always recorded. Off by default: full continuous
	  logging whenever a card is present.

module = RDD2_FLIGHT_LOG
module-str = rdd2 flight log
source "subsys/logging/Kconfig.template.log_config"

endif # RDD2_FLIGHT_LOG
```

## subsys/gnss_source/Kconfig
```kconfig
choice RDD2_GNSS_SOURCE
	prompt "Source for the gnss topic"
	default RDD2_GNSS_SOURCE_ONBOARD if DT_HAS_COGNIPILOT_UBX_GNSS_ENABLED
	default RDD2_GNSS_SOURCE_LOCKSTEP if RDD2_LOCKSTEP
	default RDD2_GNSS_SOURCE_RADIO
	help
	  Which producer publishes the gnss_fix topic. The sources are mutually
	  exclusive by construction: the choice decides which one registers as
	  the topic's single publisher, so a fix can only ever have one origin
	  and an injected fix cannot silently race an onboard one.

config RDD2_GNSS_SOURCE_RADIO
	bool "Injected over the zros serial link"
	help
	  The serial transport carries the gnss_fix topic inbound and is its
	  registered publisher. A ground station or a mocap bridge supplies the
	  fix over the radio. This is the right choice for indoor flight, where
	  the receiver may be plugged in but has no sky view and position comes
	  from motion capture instead.

	  Reached with the mocap-gnss snippet, which also disables the
	  devicetree gnss node so the reader is not compiled in and its UART
	  stays free.

config RDD2_GNSS_SOURCE_ONBOARD
	bool "Onboard u-blox receiver read as UBX"
	depends on DT_HAS_COGNIPILOT_UBX_GNSS_ENABLED
	select RING_BUFFER
	select UART_INTERRUPT_DRIVEN
	help
	  This reader publishes the gnss_fix topic and the serial transport
	  streams it out as telemetry. This is the default whenever the
	  devicetree gnss node is enabled.

	  Configures the M10 deterministically over UBX-CFG-VALSET, then decodes
	  UBX-NAV-PVT. Boot configuration enables UBX on receiver UART1 at
	  115200 baud, disables NMEA output, selects the airborne 2g dynamics
	  model, and requests NAV-PVT at 10 Hz. Configuration ACK, fix quality,
	  accuracy, age, and observed rate all remain fail-closed readiness gates.

	  Once ready, NAV-PVT publishes the accuracy estimates NMEA cannot express.
	  Before readiness or after a gate drops, the topic is actively refreshed
	  as NoFix with unusable accuracy sentinels so consumers cannot replay an
	  earlier usable sample.

	  The receiver's serial rate must match current-speed on the parent
	  UART.

config RDD2_GNSS_SOURCE_LOCKSTEP
	bool "Injected by deterministic lockstep"
	depends on RDD2_LOCKSTEP
	help
	  The lockstep coordinator publishes a synthetic 10 Hz GNSS fix in the
	  simulated boot-time domain. This source owns an immutable GPS origin and
	  disables external odometry like the onboard receiver; it is not a radio
	  or motion-capture compatibility profile.

config RDD2_GNSS_SOURCE_MESH
	bool "Received over the mesh from the rtk_gnss grandmaster"
	depends on CSYN
	help
	  The system GNSS fix arrives over the network. The rtk_gnss grandmaster
	  publishes GnssFixData on the shared "gnss" key, CSyn delivers it into
	  its lock-free latest-sample store, and this backend identity-copies each
	  newly received sample onto the gnss_fix topic as its single publisher.

	  This is the right choice for a mesh node with no local sky view that
	  takes position, corrections, and time from the fleet. The serial
	  transport still streams gnss_fix outbound as telemetry.

endchoice

if RDD2_GNSS_SOURCE_ONBOARD

config RDD2_GNSS_UBX_MAX_PAYLOAD
	int "Largest UBX payload buffered"
	default 160
	range 144 512
	help
	  The complete boot CFG-VALSET payload is 144 bytes and NAV-PVT is 92
	  bytes. Larger frames from other message classes are counted and skipped
	  in their entirety rather than buffered, including their checksums.

config RDD2_GNSS_UBX_RX_RING_SIZE
	int "Receive ring buffer size in bytes"
	default 512
	range 128 4096
	help
	  Must hold one poll period of line rate: at 115200 baud a 5 ms period
	  is about 58 bytes, so the default leaves generous headroom for burst
	  arrival.

config RDD2_GNSS_UBX_POLL_MS
	int "Reader thread poll period in milliseconds"
	default 5
	range 1 100
	help
	  The same low-priority polling loop drains received bytes and advances
	  bounded configuration retry/timeout state. It never waits synchronously
	  for an ACK.

config RDD2_GNSS_UBX_THREAD_PRIORITY
	int "Reader thread priority"
	default 7
	help
	  Must stay preemptible and below the control loop. A cooperative
	  (negative) priority here would let NMEA/UBX parsing block the
	  1600 Hz loop, which SPEC_0002 and SPEC_0005 forbid.

config RDD2_GNSS_UBX_THREAD_STACK_SIZE
	int "Reader thread stack size"
	default 1536
	range 1024 8192

endif

if RDD2_GNSS_SOURCE_MESH

config RDD2_GNSS_MESH_POLL_MS
	int "Mesh GNSS poll period in milliseconds"
	default 50
	range 1 1000
	help
	  Cadence at which the backend checks the CSyn "gnss" store for a newly
	  received producer generation. The grandmaster publishes at a low rate,
	  so a poll well under the publish period bounds end-to-end latency
	  without busy-waiting.

config RDD2_GNSS_MESH_THREAD_PRIORITY
	int "Mesh GNSS thread priority"
	default 7
	help
	  Must stay preemptible and below the control loop. A cooperative
	  (negative) priority here would let the copy block the 1600 Hz loop,
	  which SPEC_0002 and SPEC_0005 forbid.

config RDD2_GNSS_MESH_THREAD_STACK_SIZE
	int "Mesh GNSS thread stack size"
	default 1536
	range 1024 8192

endif
```

## subsys/lockstep/Kconfig
```kconfig
config RDD2_FASTDYN
	bool "Enable FastDyn hardware-target lockstep adapters"
	default n
	help
	  Build the MR-VMU-Tropic image with the fake RC, IMU, and DSHOT
	  boundary while retaining the Cortex-M7 image and Zephyr kernel.

config RDD2_LOCKSTEP
	bool "Enable deterministic lockstep"
	depends on BOARD_NATIVE_SIM || RDD2_FASTDYN
	select CEREBRI_LOCKSTEP
	default y
	help
	  Use generated synapse_fbs payloads with direct shared-memory sequencing
	  for deterministic simulation.

if RDD2_LOCKSTEP

config RDD2_LOCKSTEP_THREAD_PRIORITY
	int "Lockstep coordinator thread priority"
	default 7
	help
	  Run after Rate, Navigation, Planning, and Guidance so one exchange cannot
	  preempt the control-domain consumers whose outputs it reports.

config RDD2_LOCKSTEP_THREAD_STACK_SIZE
	int "Lockstep coordinator stack size"
	default 4096

endif
```
