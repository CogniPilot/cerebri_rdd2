## subsys/optical_flow_source/Kconfig
```kconfig
config RDD2_OPTICAL_FLOW_SOURCE_WIRE
	bool "Fuse range-compensated optical-flow velocity received over the Synapse wire"
	depends on RDD2_SYNAPSE_WIRE
	default n
	help
	  Subscribe to the fixed-layout Synapse optical-flow velocity topic that
	  the direct wire receiver publishes and feed validated planar body-frame
	  velocity into the generated navigation estimator. The producer must have
	  already applied camera mounting, range, and tilt compensation and must
	  identify the sample as gPTP synchronized or in gPTP holdover. GPS remains
	  enabled and provides the position anchor. This mirrors the wire GNSS
	  source: the same direct UDP/IPv6 receiver validates the datagram.

if RDD2_OPTICAL_FLOW_SOURCE_WIRE

config RDD2_OPTICAL_FLOW_SENSOR_ID
	int "Accepted optical-flow sensor id"
	default 0
	range 0 255

config RDD2_OPTICAL_FLOW_MIN_QUALITY
	int "Minimum accepted optical-flow quality"
	default 100
	range 1 255

config RDD2_OPTICAL_FLOW_MAX_AGE_MS
	int "Maximum time since a valid flow sample arrived"
	default 150
	range 10 1000
	help
	  Age is measured in the VMU control clock from receipt, because the
	  producer timestamp is in the gPTP domain while the IMU timestamp is in
	  the local sensor-clock domain.

config RDD2_OPTICAL_FLOW_MIN_DISTANCE_MM
	int "Minimum trusted ground distance in millimeters"
	default 50
	range 1 10000

config RDD2_OPTICAL_FLOW_MAX_DISTANCE_MM
	int "Maximum trusted ground distance in millimeters"
	default 5000
	range 100 20000

config RDD2_OPTICAL_FLOW_MAX_TILT_MRAD
	int "Maximum accepted absolute roll or pitch in milliradians"
	default 700
	range 50 1570

config RDD2_OPTICAL_FLOW_MAX_SPEED_MM_S
	int "Maximum accepted planar speed component in millimeters per second"
	default 10000
	range 100 50000

config RDD2_OPTICAL_FLOW_BEST_STDDEV_MM_S
	int "Velocity standard deviation at quality 255 in millimeters per second"
	default 100
	range 1 5000

config RDD2_OPTICAL_FLOW_WORST_STDDEV_MM_S
	int "Velocity standard deviation at minimum quality in millimeters per second"
	default 1000
	range 1 10000

config RDD2_OPTICAL_FLOW_RANGE_STDDEV_MM
	int "Downward range standard deviation in millimeters"
	default 50
	range 0 5000
	help
	  The estimator forms the velocity observation as range times flow over
	  the integration time, so range uncertainty enters the observation
	  covariance through that product. 50 mm reproduces the 0.0025 m2 the
	  mission model declares as opticalFlowGroundDistanceVariance_m2.

config RDD2_OPTICAL_FLOW_NOMINAL_PERIOD_MS
	int "Nominal optical-flow sample period in milliseconds"
	default 25
	range 1 1000
	help
	  The wire OpticalFlowVelocity sample carries no integration time, so the
	  adapter derives the exposure window from the interval between accepted
	  samples. This nominal period is used for the first accepted sample after
	  init and after an interval is rejected. 25 ms matches the roughly 34 Hz
	  frame rate of the flow sensor.

config RDD2_OPTICAL_FLOW_MIN_INTEGRATION_MS
	int "Minimum accepted flow integration interval in milliseconds"
	default 5
	range 1 1000
	help
	  Intervals below this are treated as duplicated or clock-glitched frames
	  and rejected rather than used to weight the observation.

config RDD2_OPTICAL_FLOW_MAX_INTEGRATION_MS
	int "Maximum accepted flow integration interval in milliseconds"
	default 200
	range 1 5000
	help
	  Intervals above this indicate a dropout since the previous fused frame.
	  The sample is rejected and the interval restarts at the nominal period.

config RDD2_OPTICAL_FLOW_COMPENSATION_RATE_URAD_S_RTHZ
	int "Gyro rotation-compensation rate-noise density in microrad/s/sqrt(Hz)"
	default 5000
	range 1 1000000
	help
	  The CSyn producer removes camera rotation before reporting velocity,
	  leaving a residual whose integrated-angle variance grows with the
	  exposure window. The firmware forms that residual variance as the square
	  of this rate-noise density times the integration time. 5000 urad/s/sqrt(Hz)
	  (5e-3 rad/s/sqrt(Hz)) matches the ICM45686 gyro and yields about 6e-7 rad2
	  over a 25 ms exposure.

endif

config RDD2_OPTICAL_FLOW_SOURCE_WIRE_RAW
	bool "Fuse the raw Synapse OpticalFlowData over the wire (tightly coupled)"
	depends on RDD2_SYNAPSE_WIRE
	depends on !RDD2_OPTICAL_FLOW_SOURCE_WIRE
	default n
	help
	  Subscribe to the fixed-layout Synapse OpticalFlowData topic (integrated
	  flow angles, the node's integrated delta angle over the same window,
	  integration time, range and quality) that the direct wire receiver
	  publishes, and feed it to the generated navigation estimator. The
	  estimator forms the body velocity itself from the gyro-compensated
	  line-of-sight integral, so it weights the flow, the rotation compensation
	  and the range independently rather than trusting the node's pre-computed
	  velocity. Mutually exclusive with RDD2_OPTICAL_FLOW_SOURCE_WIRE, which
	  fuses the node's derived velocity instead. GPS remains enabled and
	  provides the position anchor.

config RDD2_OPTICAL_FLOW_SOURCE_LOCKSTEP_RAW
	bool "Fuse raw OpticalFlowData supplied by the lockstep coordinator"
	depends on RDD2_LOCKSTEP
	depends on !RDD2_OPTICAL_FLOW_SOURCE_WIRE
	depends on !RDD2_OPTICAL_FLOW_SOURCE_WIRE_RAW
	default n
	help
	  Feed the generated navigation estimator the fixed-layout OpticalFlowData
	  sample the lockstep coordinator places in shared memory each exchange,
	  through the same raw adapter the direct wire uses. The rehosted and
	  native lockstep images use this to exercise flow-aided navigation from
	  a plant-derived flow sensor.

config RDD2_OPTICAL_FLOW_RAW
	bool
	default y if RDD2_OPTICAL_FLOW_SOURCE_WIRE_RAW || RDD2_OPTICAL_FLOW_SOURCE_LOCKSTEP_RAW
	help
	  The raw OpticalFlowData fusion path is compiled in for whichever source
	  delivers the sample.

if RDD2_OPTICAL_FLOW_RAW

config RDD2_OPTICAL_FLOW_RAW_SENSOR_ID
	int "Accepted optical-flow sensor id"
	default 0
	range 0 255

config RDD2_OPTICAL_FLOW_RAW_MIN_QUALITY
	int "Minimum accepted flow quality (0 to 255)"
	default 100
	range 1 255

config RDD2_OPTICAL_FLOW_RAW_MAX_AGE_MS
	int "Maximum time since a valid flow sample arrived"
	default 150
	range 10 1000
	help
	  Age is measured in the VMU control clock from receipt, because the
	  producer timestamp is in the gPTP domain while the IMU timestamp is in
	  the local sensor-clock domain.

config RDD2_OPTICAL_FLOW_RAW_MIN_DISTANCE_MM
	int "Minimum trusted ground distance in millimeters"
	default 50
	range 1 10000

config RDD2_OPTICAL_FLOW_RAW_MAX_DISTANCE_MM
	int "Maximum trusted ground distance in millimeters"
	default 5000
	range 100 20000

config RDD2_OPTICAL_FLOW_RAW_MIN_INTEGRATION_MS
	int "Minimum accepted flow integration interval in milliseconds"
	default 5
	range 1 1000
	help
	  The window is carried in the sample as integration_timespan_ns. Windows
	  shorter than this are treated as duplicated or clock-glitched frames.

config RDD2_OPTICAL_FLOW_RAW_MAX_INTEGRATION_MS
	int "Maximum accepted flow integration interval in milliseconds"
	default 200
	range 1 5000
	help
	  Windows longer than this indicate a dropout since the previous frame and
	  are rejected.

config RDD2_OPTICAL_FLOW_RAW_LOS_FLOOR_URAD
	int "Line-of-sight noise floor in microradians"
	default 300
	range 0 100000
	help
	  The per-window line-of-sight standard deviation is this floor plus a
	  sensitivity fraction times the flow angle. The floor keeps a very small
	  flow angle from claiming an unrealistically tight variance.

config RDD2_OPTICAL_FLOW_RAW_LOS_SENS_BEST_PERMILLE
	int "Line-of-sight sensitivity uncertainty at quality 255, per mille"
	default 50
	range 0 1000
	help
	  Fractional per-count sensitivity uncertainty applied to the flow angle at
	  the best reported quality, in parts per thousand (50 is five percent).

config RDD2_OPTICAL_FLOW_RAW_LOS_SENS_WORST_PERMILLE
	int "Line-of-sight sensitivity uncertainty at minimum quality, per mille"
	default 250
	range 0 2000
	help
	  Fractional per-count sensitivity uncertainty applied to the flow angle at
	  the minimum accepted quality, in parts per thousand.

config RDD2_OPTICAL_FLOW_RAW_GYRO_RATE_NOISE_URAD_S_RTHZ
	int "Integrated-gyro rate-noise density in microrad/s/sqrt(Hz)"
	default 3800
	range 1 1000000
	help
	  The ICM45686 gyro rate-noise density. The integrated-angle variance grows
	  with the exposure window as an angle random walk, so the firmware forms
	  it as the square of this density times the integration time.

config RDD2_OPTICAL_FLOW_RAW_RANGE_BEST_STDDEV_MM
	int "Downward range standard deviation at distance quality 255, millimeters"
	default 30
	range 0 5000

config RDD2_OPTICAL_FLOW_RAW_RANGE_WORST_STDDEV_MM
	int "Downward range standard deviation at distance quality 0, millimeters"
	default 150
	range 0 10000

choice
	prompt "Flow carrier mount yaw from vehicle FLU to carrier FLU"
	default RDD2_OPTICAL_FLOW_RAW_MOUNT_YAW_0
	help
	  Applied to both the flow angles and the delta angle. Determine it with
	  tools/log_replay/flow_calibrate.py.

config RDD2_OPTICAL_FLOW_RAW_MOUNT_YAW_0
	bool "0 degrees"

config RDD2_OPTICAL_FLOW_RAW_MOUNT_YAW_90
	bool "90 degrees"

config RDD2_OPTICAL_FLOW_RAW_MOUNT_YAW_180
	bool "180 degrees"

config RDD2_OPTICAL_FLOW_RAW_MOUNT_YAW_270
	bool "270 degrees"

endchoice

config RDD2_OPTICAL_FLOW_RAW_MOUNT_YAW_DEG
	int
	default 0 if RDD2_OPTICAL_FLOW_RAW_MOUNT_YAW_0
	default 90 if RDD2_OPTICAL_FLOW_RAW_MOUNT_YAW_90
	default 180 if RDD2_OPTICAL_FLOW_RAW_MOUNT_YAW_180
	default 270 if RDD2_OPTICAL_FLOW_RAW_MOUNT_YAW_270

endif
```

## subsys/power_source/Kconfig
```kconfig
config RDD2_POWER_SOURCE
	bool "Battery voltage and current from an I2C power monitor"
	default n
	depends on SENSOR
	help
	  Poll the sensor on the power0 devicetree alias (an INA226 on the
	  CogniPilot power module) every 100 ms from the system work queue and
	  publish bus voltage, pack current, and an estimated remaining percent
	  into the vehicle_health topic. The rate loop only reads the cached
	  values, so no I2C transfer ever runs on the 800 Hz path.

if RDD2_POWER_SOURCE

config RDD2_POWER_SOURCE_ESR_MOHM
	int "Internal resistance per cell in milliohm"
	default 5
	range 0 100
	help
	  Undoes the voltage sag under load before the state of charge is read
	  off the cell curve, so the reported percent does not dip with the
	  throttle. Typical for a healthy LiPo cell is 4 to 6 milliohm. Set 0
	  to report the terminal voltage unchanged.

module = RDD2_POWER_SOURCE
module-str = rdd2 power source
source "subsys/logging/Kconfig.template.log_config"

endif # RDD2_POWER_SOURCE
```

## subsys/zros_serial/Kconfig
```kconfig
config RDD2_ZROS_SERIAL
	bool "Enable the synapse serial transport"
	depends on ZROS
	depends on SERIAL
	depends on SERIAL_SUPPORT_INTERRUPT
	select UART_INTERRUPT_DRIVEN
	select RING_BUFFER
	select CRC
	default n
	help
	  Carry ZROS topics over a plain UART using the compact synapse
	  serial framing described in fbs/transport.fbs:
	  [sync][len][topic_id][seq][flags][bare payload][crc16].

	  This is the transport for constrained links such as a SiK
	  telemetry radio. Inbound frames are published onto ZROS, outbound
	  topics are read from ZROS and rate limited to fit the air rate.
	  Requires a "zros-serial" devicetree alias naming the UART.

	  CSyn is not involved. The wire ids are synapse catalog TopicIds,
	  which is schema shared with the ground-side peer, not a dependency
	  on the CSyn transport: that one carries the same topics over
	  Ethernet and Zenoh independently of this link.

if RDD2_ZROS_SERIAL

config RDD2_ZROS_SERIAL_MAX_PAYLOAD
	int "Largest topic payload carried over the serial link"
	default 128
	range 8 512
	help
	  Frames with a larger payload are dropped and counted. Fixed-layout
	  struct topics are at most 64 bytes in synapse_fbs 0.7, so the
	  default leaves headroom without reserving a full flatbuffer buffer.

config RDD2_ZROS_SERIAL_TX_MIN_INTERVAL_MS
	int "Minimum milliseconds between frames of the same topic"
	default 200
	range 0 10000
	help
	  Per-topic decimation for the outbound direction. The flight state
	  topics publish at 200 Hz, which is roughly seven times what a
	  57600 baud SiK link can carry, so outbound topics are throttled
	  rather than dropped at the UART. 200 ms gives 5 Hz per topic.

config RDD2_ZROS_SERIAL_RX_RING_SIZE
	int "Receive ring buffer size in bytes"
	default 512
	range 64 4096

config RDD2_ZROS_SERIAL_TX_RING_SIZE
	int "Transmit ring buffer size in bytes"
	default 1024
	range 64 8192

config RDD2_ZROS_SERIAL_POLL_MS
	int "Transport thread poll period in milliseconds"
	default 5
	range 1 100

config RDD2_ZROS_SERIAL_THREAD_PRIORITY
	int "Transport thread priority"
	default 7
	help
	  Must stay below the control loop and the CRSF input thread. The
	  transport never touches the rate loop.

config RDD2_ZROS_SERIAL_THREAD_STACK_SIZE
	int "Transport thread stack size"
	default 2048
	range 1024 8192

endif
```

## tests/crsf_telemetry_encode/testcase.yaml
```yaml
tests:
  rdd2.crsf_telemetry_encode:
    platform_allow:
      - native_sim/native/64
    harness: console
    harness_config:
      type: one_line
      regex:
        - "PASS"
    tags:
      - rdd2
      - crsf
      - telemetry
```

## tests/flight_log_rotation/testcase.yaml
```yaml
tests:
  rdd2.flight_log_rotation.deferred:
    platform_allow:
      - native_sim/native/64
    tags:
      - rdd2
      - flight_log
  rdd2.flight_log_rotation.eager:
    platform_allow:
      - native_sim/native/64
    tags:
      - rdd2
      - flight_log
    extra_args:
      - RDD2_FLIGHT_LOG_EAGER_ROTATE=y
```

## tests/generated_guidance_validity/testcase.yaml
```yaml
tests:
  rdd2.generated_guidance_validity:
    platform_allow:
      - native_sim/native/64
    tags:
      - rdd2
      - safety
      - generated
      - guidance
```

## tests/generated_navigation_fault_injection/testcase.yaml
```yaml
tests:
  rdd2.generated_navigation_fault_injection:
    platform_allow:
      - native_sim/native/64
    tags:
      - rdd2
      - safety
      - generated
      - navigation
```

## tests/gnss_lockstep_source/testcase.yaml
```yaml
tests:
  rdd2.gnss_lockstep_source:
    platform_allow:
      - native_sim/native/64
    integration_platforms:
      - native_sim/native/64
    tags:
      - gnss
      - lockstep
```

## tests/gnss_m10_protocol/testcase.yaml
```yaml
tests:
  rdd2.gnss_m10_protocol:
    platform_allow:
      - native_sim/native/64
    tags:
      - rdd2
      - gnss
      - safety
```

## tests/lockstep_transport/testcase.yaml
```yaml
tests:
  rdd2.lockstep_transport:
    platform_allow:
      - native_sim/native/64
    tags:
      - rdd2
      - lockstep
      - safety
```

## tests/mission_shell/testcase.yaml
```yaml
tests:
  rdd2.mission_shell.ingress:
    platform_allow:
      - native_sim/native/64
    tags:
      - rdd2
      - mission
      - shell
```

## tests/navigation_optical_flow/testcase.yaml
```yaml
tests:
  rdd2.navigation_optical_flow:
    platform_allow:
      - native_sim/native/64
    tags:
      - rdd2
      - optical-flow
      - safety
      - navigation
```

## tests/process_control_safety/testcase.yaml
```yaml
tests:
  rdd2.process_control_safety:
    platform_allow:
      - native_sim/native/64
    tags:
      - rdd2
      - safety
```

## tests/process_wrapper_fault_injection/testcase.yaml
```yaml
tests:
  rdd2.process_wrapper_fault_injection.wrappers:
    platform_allow:
      - native_sim/native/64
    tags:
      - rdd2
      - safety
      - wrapper
```

## tests/waypoint_mission_ingress/testcase.yaml
```yaml
tests:
  rdd2.waypoint_mission_ingress.lifecycle:
    platform_allow:
      - native_sim/native/64
    tags:
      - rdd2
      - safety
      - mission
```
