## src/diagnostics/Kconfig
```kconfig
config RDD2_STEP_TIMING
	bool "Measure the periodic control path with the DWT cycle counter"
	depends on CPU_CORTEX_M
	default n
	help
	  Bracket the generated control steps with the Cortex-M7 DWT cycle
	  counter and log a worst case, mean, and coarse histogram at a low
	  rate. Intended for bench work on real silicon: it is the only way to
	  observe external-flash wait states and cache behaviour, which the
	  rehosted FastDyn image cannot model. Numbers produced under FastDyn
	  are QEMU artefacts and are labelled as such. Off by default so flight
	  images carry no instrumentation.
```

## subsys/Kconfig
```kconfig
menu "Subsystems"

rsource "zros_serial/Kconfig"
rsource "gnss_source/Kconfig"
rsource "lockstep/Kconfig"
rsource "synapse_wire/Kconfig"
rsource "flight_log/Kconfig"

endmenu
```

## subsys/crsf_telemetry/Kconfig
```kconfig
config RDD2_CRSF_TELEMETRY
	bool "CRSF telemetry to the ELRS receiver"
	default n
	depends on INPUT_CRSF
	help
	  Feed the receiver's downlink with plain CRSF telemetry frames (GPS,
	  battery, flight mode, ESC RPM) and with the Yaapu passthrough frames the
	  Yaapu telemetry script on the transmitter decodes. One subscriber
	  thread reads the flight bus and paces the frames, so telemetry never
	  exceeds the downlink budget and the frames leave in a fixed rotation
	  rather than in bursts.

if RDD2_CRSF_TELEMETRY

config RDD2_CRSF_TELEMETRY_ATTITUDE_PERIOD_MS
	int "Attitude passthrough period in milliseconds"
	default 100
	range 50 10000
	help
	  Period of the roll/pitch and velocity/yaw passthrough group, the
	  fastest-changing values on the transmitter screen.

	  The defaults are sized for ELRS 2.4 GHz at a 500 Hz packet rate
	  with a 1:4 telemetry ratio, which the ELRS documentation rates at
	  4687 bit/s, about 585 bytes/s of CRSF frames shared with the
	  receiver's own link statistics.

	  The receiver queues telemetry in a 512 byte FIFO. Broadcast frame
	  types (GPS, battery, flight mode) overwrite the older queued frame
	  of the same type and stay fresh, but every custom telemetry frame
	  (type 0x80, all the passthrough groups) is appended, so if those
	  are offered faster than the link drains them the FIFO fills and a
	  status frame with an armed or failsafe edge waits seconds behind
	  attitude frames. The arm state therefore rides the flight mode
	  string, a broadcast frame, and the attitude group runs at 10 Hz.
	  Measured with the radio's telemetry mirror: a 1:8 link delivers
	  about 8 custom frames per second in total and drops the rest,
	  a 1:4 link keeps up with 10 Hz attitude plus the slow groups.
	  On a 1:8 link raise this period to 170 ms, on 1:16 to 500 ms.

	  The native RPM frame (type 0x0C, 17 bytes on the wire) carries the
	  four motors at 4 Hz, about 68 bytes/s. It is a broadcast type, so a
	  queued frame is overwritten by the next one instead of piling up in
	  the receiver FIFO.

config RDD2_CRSF_TELEMETRY_STATUS_PERIOD_MS
	int "Status passthrough period in milliseconds"
	default 1000
	range 50 10000
	help
	  Period of the flight-mode/armed, GPS-status and home passthrough
	  group. These change slowly, so they carry the cheaper rate in the
	  budget described above.

config RDD2_CRSF_TELEMETRY_MOTOR_POLES
	int "Motor magnet count"
	default 14
	range 2 64
	help
	  Number of magnets on the motor bell, used to turn the eRPM the ESCs
	  report over bidirectional DShot into the mechanical RPM the CRSF RPM
	  frame carries: RPM = eRPM * 2 / poles. Count the magnets, not the
	  stator teeth; 14 covers most 5 inch and 7 inch quadrotor motors.

config RDD2_CRSF_TELEMETRY_THREAD_STACK_SIZE
	int "Telemetry thread stack size"
	default 2048
	range 1024 8192

config RDD2_CRSF_TELEMETRY_THREAD_PRIORITY
	int "Telemetry thread priority"
	default 9
	help
	  Runs below every flight and wire thread (priorities 2 through 7) and
	  below the flight log writer at 8, and above the background floor
	  threads at 14. A frame is sent as a synchronous poll-out of about
	  24 us per byte, so it must never be able to delay the flight loop or
	  the card writer; nothing downstream of it depends on telemetry
	  latency.

endif # RDD2_CRSF_TELEMETRY
```

## subsys/csyn_serial/Kconfig
```kconfig
config RDD2_CSYN_SERIAL
	bool "Enable the CSyn serial transport"
	depends on CSYN
	depends on SERIAL
	depends on SERIAL_SUPPORT_INTERRUPT
	select UART_INTERRUPT_DRIVEN
	select RING_BUFFER
	select CRC
	default n
	help
	  Carry declared CSyn topics over a plain UART using the compact
	  synapse serial framing described in fbs/transport.fbs:
	  [sync][len][topic_id][seq][flags][bare payload][crc16].

	  This is the transport for constrained links such as a SiK
	  telemetry radio. Inbound frames are published into the CSyn topic
	  store, outbound topics are rate limited to fit the air rate.
	  Requires a "csyn-serial" devicetree alias naming the UART.

if RDD2_CSYN_SERIAL

config RDD2_CSYN_SERIAL_MAX_PAYLOAD
	int "Largest topic payload carried over the serial link"
	default 128
	range 8 512
	help
	  Frames with a larger payload are dropped and counted. Fixed-layout
	  struct topics are at most 64 bytes in synapse_fbs 0.7, so the
	  default leaves headroom without reserving a full flatbuffer buffer.

config RDD2_CSYN_SERIAL_TX_MIN_INTERVAL_MS
	int "Minimum milliseconds between frames of the same topic"
	default 200
	range 0 10000
	help
	  Per-topic decimation for the outbound direction. The flight state
	  topics publish at 200 Hz, which is roughly seven times what a
	  57600 baud SiK link can carry, so outbound topics are throttled
	  rather than dropped at the UART. 200 ms gives 5 Hz per topic.

config RDD2_CSYN_SERIAL_RX_RING_SIZE
	int "Receive ring buffer size in bytes"
	default 512
	range 64 4096

config RDD2_CSYN_SERIAL_TX_RING_SIZE
	int "Transmit ring buffer size in bytes"
	default 1024
	range 64 8192

config RDD2_CSYN_SERIAL_MAX_TOPICS
	int "Maximum declared CSyn topics tracked by this transport"
	default 32
	range 1 64

config RDD2_CSYN_SERIAL_POLL_MS
	int "Transport thread poll period in milliseconds"
	default 5
	range 1 100

config RDD2_CSYN_SERIAL_THREAD_PRIORITY
	int "Transport thread priority"
	default 7
	help
	  Must stay below the control loop and the CRSF input thread. The
	  transport never touches the rate loop.

config RDD2_CSYN_SERIAL_THREAD_STACK_SIZE
	int "Transport thread stack size"
	default 2048
	range 1024 8192

config RDD2_CSYN_SERIAL_ECHO_KEY
	string "Also transmit this inbound topic"
	default ""
	help
	  Wire key of one CSYN_DIR_RX topic to stream back out as telemetry in
	  addition to accepting it inbound. Empty, the default, echoes nothing.

	  This exists for the case where the vehicle's only knowledge of some
	  state is what was injected into it. With the gnss topic inbound there
	  is no onboard receiver and no estimator downstream of the fix, so a
	  ground station would otherwise get no position at all; echoing the
	  accepted fix is what lets it draw the vehicle on a map, and it doubles
	  as proof the injected frame was accepted rather than counted as an
	  error.

	  The echo is rate-limited and change-detected like any other outbound
	  topic, so it costs one frame per TX interval, not one per injection.
	  A ground station must not re-inject what it receives here: that closes
	  a loop the transport cannot detect, because an echoed frame is
	  indistinguishable from a fresh one.

	  An unknown key is reported at init and otherwise ignored.

endif
```
