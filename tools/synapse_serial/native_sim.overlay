/* SPDX-License-Identifier: Apache-2.0 */

/*
 * Opt-in harness: points the zros serial transport at native_sim's second PTY
 * UART so the real firmware framer and parser can be driven from the host by
 * synapse_serial.py. Not part of any default image; pass it explicitly with
 * EXTRA_DTC_OVERLAY_FILE. See README.md.
 */

&uart1 {
	status = "okay";
};

/ {
	aliases {
		zros-serial = &uart1;
		/* Same port, so `zros_serial scan` can be exercised too: the
		 * scan takes RX interrupts back from the transport for its
		 * duration and returns them afterwards. */
		zros-scan0 = &uart1;
	};
};
