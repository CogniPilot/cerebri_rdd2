## CMakeLists.txt
```
# SPDX-License-Identifier: Apache-2.0

cmake_minimum_required(VERSION 3.20.0)

find_package(Zephyr REQUIRED HINTS $ENV{ZEPHYR_BASE})
project(flight_log_rotation)

set(FLIGHT_LOG_DIR "${CMAKE_CURRENT_LIST_DIR}/../../subsys/flight_log")

# The fake synapse, zros, and interface headers must shadow any that a module
# might contribute, so place them ahead of every other include directory.
target_include_directories(app BEFORE PRIVATE
  "${CMAKE_CURRENT_LIST_DIR}/fake_include"
)
target_include_directories(app PRIVATE
  "${CMAKE_CURRENT_LIST_DIR}/src"
  "${FLIGHT_LOG_DIR}"
)

target_sources(app PRIVATE
  "${FLIGHT_LOG_DIR}/flight_log.c"
  src/fakes.c
  src/main.c
)

# The flight logger reads its tuning from Kconfig. The suite does not enable the
# CONFIG_RDD2_FLIGHT_LOG driver stack (it selects on-target SD hardware), so the
# tuning is supplied directly. The rotation, pool and growth-step sizes are
# scaled down so several size-triggered rotations occur within the run while the
# ring stays at its real 131072-byte size.
target_compile_definitions(app PRIVATE
  CONFIG_RDD2_FLIGHT_LOG_LOG_LEVEL=1
  CONFIG_RDD2_FLIGHT_LOG_RING_BYTES=131072
  CONFIG_RDD2_FLIGHT_LOG_BLOCK_BYTES=4096
  CONFIG_RDD2_FLIGHT_LOG_ROTATE_BYTES=262144
  # Four pool slots at the scaled rotation size, so the refill of a consumed
  # slot is exercised without stretching the run.
  CONFIG_RDD2_FLIGHT_LOG_RESERVE_BYTES=1048576
  CONFIG_RDD2_FLIGHT_LOG_PREALLOC_STEP_BYTES=32768
  # Scale the reservation floor below the scaled rotation size so the inline
  # reservation path actually reserves (in the flight image the 256 MiB rotation
  # size sits far above the 4 MiB floor). The fake sink turns that reservation
  # into the injected multi-second card stall.
  FLIGHT_LOG_PREALLOC_FLOOR_BYTES=65536
  CONFIG_RDD2_FLIGHT_LOG_TIMEREF_PERIOD_MS=100
  CONFIG_RDD2_FLIGHT_LOG_FLUSH_PERIOD_MS=400
  CONFIG_RDD2_FLIGHT_LOG_RETRY_MS=200
  CONFIG_RDD2_FLIGHT_LOG_WRITER_STACK_SIZE=8192
  CONFIG_RDD2_FLIGHT_LOG_WRITER_PRIORITY=8
  CONFIG_RDD2_FLIGHT_LOG_FRONT_STACK_SIZE=8192
  CONFIG_RDD2_FLIGHT_LOG_FRONT_PRIORITY=4
)

# The eager (pre-deferral) rotation logic is selected for the comparison run.
if(RDD2_FLIGHT_LOG_EAGER_ROTATE)
  target_compile_definitions(app PRIVATE CONFIG_RDD2_FLIGHT_LOG_EAGER_ROTATE=1)
endif()
```

## prj.conf
```kconfig
CONFIG_ZTEST=y
CONFIG_ASSERT=y
CONFIG_LOG=y
CONFIG_LOG_MODE_MINIMAL=y
CONFIG_RING_BUFFER=y
CONFIG_RING_BUFFER_LARGE=y
CONFIG_EVENTS=y
CONFIG_MAIN_THREAD_PRIORITY=0
CONFIG_ZTEST_STACK_SIZE=16384
CONFIG_SYS_CLOCK_TICKS_PER_SEC=100000
CONFIG_TEST_RANDOM_GENERATOR=y
```

## src/main.c
```c
/* SPDX-License-Identifier: Apache-2.0 */

/*
 * Flight-log rotation regression suite.
 *
 * Runs the production flight_log.c capture and writer threads, ring, session
 * rotation, and standing-reservation pool on native_sim against a fake card that
 * injects a multi-second extent-reservation stall. The offered load mirrors the
 * recorded flight per-channel rates. Two size-triggered rotations are driven
 * with the stall active:
 *
 *   - the deferred build (default) waits for a standing reservation and a quiet
 *     ring, rotates by rename, and must drop no frames;
 *   - the eager build (CONFIG_RDD2_FLIGHT_LOG_EAGER_ROTATE) rotates at the byte
 *     threshold, hits the inline reservation stall while the ring is under
 *     load, and must overflow the ring and drop frames.
 *
 * A final phase exercises the manual-rotate path against an idle ring, which
 * must never drop frames regardless of build, and then the pool contract: the
 * standing reservations survive a stop, the next start opens its session by
 * renaming one rather than reserving inline, and the builder refills the
 * consumed slot in the background with no inline reservation anywhere.
 */

#include "harness.h"

#include "flight_log.h"

#include <zephyr/kernel.h>
#include <zephyr/ztest.h>

#define RING_BYTES ((uint32_t)CONFIG_RDD2_FLIGHT_LOG_RING_BYTES)

static struct rdd2_flight_log_status snapshot(void)
{
	struct rdd2_flight_log_status s;

	rdd2_flight_log_status_get(&s);
	return s;
}

static bool wait_for_active(int max_ms)
{
	for (int waited = 0; waited < max_ms; waited += 20) {
		if (snapshot().active) {
			return true;
		}
		k_sleep(K_MSEC(20));
	}
	return snapshot().active;
}

static bool wait_for_index(uint32_t target, int max_ms)
{
	for (int waited = 0; waited < max_ms; waited += 20) {
		struct rdd2_flight_log_status s = snapshot();

		if (s.session_index >= target) {
			return true;
		}
		if ((waited % 1000) == 0) {
			TC_PRINT("t=%dms index=%u bytes=%llu drops=%u ring_hw=%u "
				 "reservations=%u/%u\n",
				 waited, s.session_index, (unsigned long long)s.bytes_written,
				 s.dropped_frames, s.ring_high_water,
				 rdd2_test_ready_reservations(), s.reservation_slots);
		}
		k_sleep(K_MSEC(20));
	}
	return snapshot().session_index >= target;
}

static bool wait_for(bool (*predicate)(void), int max_ms)
{
	for (int waited = 0; waited < max_ms; waited += 20) {
		if (predicate()) {
			return true;
		}
		k_sleep(K_MSEC(20));
	}
	return predicate();
}

static bool session_idle(void)
{
	return !snapshot().active;
}

static bool two_reservations_ready(void)
{
	return rdd2_test_ready_reservations() >= 2U;
}

static bool pool_full(void)
{
	return rdd2_test_ready_reservations() >= snapshot().reservation_slots;
}

ZTEST(flight_log_rotation, test_rotation_ring_integrity)
{
	struct rdd2_flight_log_status s;
	struct rdd2_flight_log_status before;
	struct rdd2_flight_log_status after;
	uint32_t expands;
	uint32_t renames;

	/* Inject a three-second reservation stall, matching a mid-flight f_expand
	 * burst on a real card, and run the offered load. */
	rdd2_test_load_paused = false;
	rdd2_test_expand_stall_ms = 3800U;

	zassert_true(wait_for_active(20000), "logging session never opened");

	/* Drive past at least two size-triggered rotations. */
	zassert_true(wait_for_index(2U, 120000), "did not reach two rotations");

	s = snapshot();
	TC_PRINT("after >=2 rotations: session_index=%u dropped_frames=%u "
		 "ring_high_water=%u/%u bytes_written=%llu reservations=%u/%u\n",
		 s.session_index, s.dropped_frames, s.ring_high_water, RING_BYTES,
		 (unsigned long long)s.bytes_written, rdd2_test_ready_reservations(),
		 s.reservation_slots);

#if defined(CONFIG_RDD2_FLIGHT_LOG_EAGER_ROTATE)
	/* Eager rotation stalls the writer inline while capture keeps producing:
	 * the ring pins full and frames are lost at every rotation. */
	zassert_true(s.dropped_frames > 1000U,
		     "eager rotation should drop frames, saw %u", s.dropped_frames);
	zassert_true(s.ring_high_water > (RING_BYTES * 3U) / 4U,
		     "eager rotation should pin the ring, high water %u/%u",
		     s.ring_high_water, RING_BYTES);
#else
	/* Deferred rotation swaps a pre-built extent by rename on a quiet ring:
	 * no reservation stall reaches the streaming path, so nothing is lost. */
	zassert_equal(s.dropped_frames, 0U,
		      "deferred rotation dropped %u frames", s.dropped_frames);
	zassert_true(s.ring_high_water < RING_BYTES / 2U,
		     "deferred rotation ring high water %u should stay well below %u",
		     s.ring_high_water, RING_BYTES);
#endif

	/* Manual rotate against an idle ring: quiesce the bus, let the writer
	 * drain, then rotate through the bypass path. No frames should drop. */
	rdd2_test_load_paused = true;
	k_sleep(K_MSEC(500));

	before = snapshot();
	rdd2_flight_log_request_rotate();
	zassert_true(wait_for_index(before.session_index + 1U, 30000),
		     "manual rotate did not advance the session");

	after = snapshot();
	TC_PRINT("manual idle rotate: index %u->%u dropped %u->%u ring_high_water=%u\n",
		 before.session_index, after.session_index, before.dropped_frames,
		 after.dropped_frames, after.ring_high_water);

	zassert_equal(after.dropped_frames, before.dropped_frames,
		      "idle manual rotate dropped %u frames",
		      after.dropped_frames - before.dropped_frames);

	/* Standing pool: let the builder put two reservations on the card, then stop.
	 * Both must survive, and the next start must open its session by renaming one
	 * instead of paying the inline reservation stall. */
	zassert_true(wait_for(two_reservations_ready, 60000),
		     "the pool never reached two standing reservations");

	rdd2_flight_log_request_stop();
	zassert_true(wait_for(session_idle, 30000), "session never stopped");
	zassert_true(rdd2_test_ready_reservations() >= 2U,
		     "stop removed standing reservations, %u left",
		     rdd2_test_ready_reservations());

	before = snapshot();
	expands = rdd2_test_prealloc_count;
	renames = rdd2_test_rename_count;

	rdd2_flight_log_request_start();
	zassert_true(wait_for_active(30000), "session never restarted");

	TC_PRINT("restart from the pool: index %u->%u expands %u->%u renames %u->%u "
		 "reservations=%u/%u\n",
		 before.session_index, snapshot().session_index, expands,
		 rdd2_test_prealloc_count, renames, rdd2_test_rename_count,
		 rdd2_test_ready_reservations(), snapshot().reservation_slots);

	zassert_equal(rdd2_test_prealloc_count, expands,
		      "restart reserved inline instead of renaming a standing one");
	zassert_equal(rdd2_test_rename_count, renames + 1U,
		      "restart did not rename a standing reservation into the session");

	/* The consumed slot is refilled in the background, one reservation at a
	 * time, and the refill never falls back to an inline reservation. */
	zassert_true(wait_for(pool_full, 120000),
		     "the pool did not refill, %u of %u standing",
		     rdd2_test_ready_reservations(), snapshot().reservation_slots);
	zassert_equal(rdd2_test_prealloc_count, expands,
		      "refilling the pool reserved inline");

	TC_PRINT("pool refilled to %u/%u with %u inline reservations total\n",
		 rdd2_test_ready_reservations(), snapshot().reservation_slots,
		 rdd2_test_prealloc_count);
}

ZTEST_SUITE(flight_log_rotation, NULL, NULL, NULL, NULL, NULL);
```

## src/fakes.c
```c
/* SPDX-License-Identifier: Apache-2.0 */

/*
 * Fake filesystem, MCAP sink, subscriber bus, and boot clock for the flight-log
 * rotation suite. They let the production flight_log.c writer, ring accounting,
 * session rotation, and standing-reservation pool run on native_sim while the
 * card behaviour, including a configurable multi-second reservation stall, is
 * controlled from the test body.
 */

#include "harness.h"

#include "flight_log_fs.h"
#include "mcap_stream.h"

#include <errno.h>
#include <string.h>

#include <zephyr/fs/fs.h>
#include <zephyr/kernel.h>

#include <synapse/mcap.h>
#include <synapse/mcap_topics.h>

#include <interfaces/synapse_time_status.h>
#include <interfaces/zros_topics.h>

#include <zros/zros_node.h>
#include <zros/zros_sub.h>
#include <zros/zros_topic.h>

/* Bytes of framing the constant-memory MCAP writer adds per fixed record.
 * Combined with the 40-byte InertialSample payload this yields the recorded
 * 54 bytes per control_imu message. */
#define RDD2_FAKE_MCAP_RECORD_OVERHEAD 14U

volatile uint32_t rdd2_test_expand_stall_ms;
volatile bool rdd2_test_load_paused;
volatile uint32_t rdd2_test_prealloc_count;
volatile uint32_t rdd2_test_rename_count;

/* ---- topic handles ---- */

struct zros_topic topic_control_imu;
struct zros_topic topic_pwm_signal_outputs;
struct zros_topic topic_navigation_odometry;
struct zros_topic topic_attitude_estimate;
struct zros_topic topic_vehicle_health;
struct zros_topic topic_control_loop_metrics;
struct zros_topic topic_attitude_command;
struct zros_topic topic_rate_command;
struct zros_topic topic_manual_input;
struct zros_topic topic_optical_flow_vel;
struct zros_topic topic_optical_flow;
struct zros_topic topic_gnss_fix;

/* ---- boot clock ---- */

uint64_t synapse_time_boot_ns(void)
{
	return k_ticks_to_ns_floor64(k_uptime_ticks());
}

synapse_types_TimeStatus_enum_t synapse_time_status_resolve(bool *ever_synced, int64_t *offset_ns)
{
	if (ever_synced != NULL) {
		*ever_synced = false;
	}
	if (offset_ns != NULL) {
		*offset_ns = 0;
	}
	return synapse_types_TimeStatus_LocalFreerun;
}

uint64_t synapse_time_apply_offset(uint64_t boot_ns, int64_t offset_ns)
{
	return boot_ns + (uint64_t)offset_ns;
}

/* ---- subscriber bus ----
 *
 * The logger initialises one subscriber per source in the source-table order.
 * The recorded flight per-channel publish rates follow that same order. */
static const double g_source_rate_hz[] = {
	800.0, /* control_imu    */
	400.0, /* pwm            */
	100.0, /* odometry       */
	200.0, /* attitude       */
	193.0, /* vehicle health */
	200.0, /* loop metrics   */
	200.0, /* attitude cmd   */
	200.0, /* rate cmd       */
	380.0, /* manual         */
	34.0,  /* optical flow   */
	34.0,  /* optical flow raw */
	6.0,   /* gnss           */
};

static size_t g_sub_init_count;

void zros_node_init(struct zros_node *node, const char *name)
{
	if (node != NULL) {
		node->name = name;
	}
}

int zros_sub_init(struct zros_sub *sub, struct zros_node *node, struct zros_topic *topic,
		  void *data, double rate_limit_hz)
{
	ARG_UNUSED(node);
	ARG_UNUSED(topic);
	ARG_UNUSED(rate_limit_hz);

	if (sub == NULL) {
		return -EINVAL;
	}

	sub->source_index = (int)g_sub_init_count;
	sub->data = data;
	if (g_sub_init_count < ARRAY_SIZE(g_source_rate_hz)) {
		double hz = g_source_rate_hz[g_sub_init_count];

		sub->period_ns = hz > 0.0 ? (uint64_t)(1000000000.0 / hz) : 0U;
	} else {
		sub->period_ns = 0U;
	}
	sub->next_due_ns = 0U;
	g_sub_init_count++;
	return 0;
}

bool zros_sub_update_available(struct zros_sub *sub)
{
	if (sub == NULL || sub->period_ns == 0U || rdd2_test_load_paused) {
		return false;
	}
	return synapse_time_boot_ns() >= sub->next_due_ns;
}

int zros_sub_update(struct zros_sub *sub)
{
	uint64_t now;

	if (sub == NULL) {
		return -EINVAL;
	}

	now = synapse_time_boot_ns();
	sub->next_due_ns += sub->period_ns;
	/* Never let a scheduling gap turn into a catch-up burst: resume pacing
	 * from the present instead of replaying missed periods back to back. */
	if (sub->next_due_ns + sub->period_ns < now) {
		sub->next_due_ns = now + sub->period_ns;
	}
	return 0;
}

int zros_sub_wait_many(struct zros_sub *const *subs, size_t count, k_timeout_t timeout)
{
	ARG_UNUSED(subs);
	ARG_UNUSED(count);
	ARG_UNUSED(timeout);

	if (rdd2_test_load_paused) {
		k_sleep(K_MSEC(20));
		return -EAGAIN;
	}

	/* Advance the simulated clock one fine quantum, then report samples
	 * available so the capture loop drains every due source this quantum. */
	k_sleep(K_USEC(250));
	return 0;
}

/* ---- fake card filesystem ---- */

static K_MUTEX_DEFINE(g_card_lock);
static bool g_mounted;
static uint32_t g_mount_generation;
static uint32_t g_next_index;

/*
 * Fake card directory. Only what the session layer reads back is modelled: the
 * standing reservation pool, as a table of basename and size. Session files are
 * not modelled, since nothing looks one up, so renaming a reservation into a
 * session name simply drops its entry.
 */
#define FAKE_FILE_SLOTS 8

struct fake_file {
	char name[32];
	uint64_t size;
};

static struct fake_file g_files[FAKE_FILE_SLOTS];
static struct fake_file *g_building;

static const char *basename_of(const char *path)
{
	const char *slash = strrchr(path, '/');

	return slash != NULL ? slash + 1 : path;
}

static struct fake_file *fake_find(const char *path)
{
	const char *name = basename_of(path);

	for (size_t i = 0U; i < FAKE_FILE_SLOTS; ++i) {
		if (g_files[i].name[0] != '\0' && strcmp(g_files[i].name, name) == 0) {
			return &g_files[i];
		}
	}
	return NULL;
}

static struct fake_file *fake_create(const char *path)
{
	const char *name = basename_of(path);

	for (size_t i = 0U; i < FAKE_FILE_SLOTS; ++i) {
		if (g_files[i].name[0] == '\0') {
			strncpy(g_files[i].name, name, sizeof(g_files[i].name) - 1U);
			g_files[i].size = 0U;
			return &g_files[i];
		}
	}
	return NULL;
}

/* Basename of a pool slot, the same pattern the logger composes paths with. */
static void reserve_name(uint32_t slot, char *out, size_t cap)
{
	(void)snprintk(out, cap, RDD2_FLIGHT_LOG_RESERVE_PATTERN, (unsigned int)slot);
}

uint32_t rdd2_test_ready_reservations(void)
{
	uint32_t count = 0U;

	for (uint32_t slot = 0U; slot < RDD2_FLIGHT_LOG_RESERVE_SLOTS; ++slot) {
		char name[32];
		const struct fake_file *f;

		reserve_name(slot, name, sizeof(name));
		f = fake_find(name);
		if (f != NULL && f->size == (uint64_t)CONFIG_RDD2_FLIGHT_LOG_ROTATE_BYTES) {
			count++;
		}
	}
	return count;
}

void rdd2_flight_log_fs_lock(void)
{
	k_mutex_lock(&g_card_lock, K_FOREVER);
}

void rdd2_flight_log_fs_unlock(void)
{
	k_mutex_unlock(&g_card_lock);
}

int rdd2_flight_log_fs_mount(void)
{
	g_mounted = true;
	g_mount_generation++;
	return 0;
}

uint32_t rdd2_flight_log_fs_mount_generation(void)
{
	return g_mount_generation;
}

int rdd2_flight_log_fs_unmount(void)
{
	g_mounted = false;
	return 0;
}

bool rdd2_flight_log_fs_mounted(void)
{
	return g_mounted;
}

/* The session layer erases its reservation before streaming into it. Nothing in
 * the rotation behaviour under test depends on that erase, so the fake card just
 * accepts it. */
int rdd2_flight_log_fs_trim_file(struct fs_file_t *file, const char *name)
{
	ARG_UNUSED(file);
	ARG_UNUSED(name);
	return 0;
}

/* A defragmented card: the whole free space is one run, so the reservation is
 * never clamped below the rotation size. */
int rdd2_flight_log_fs_largest_free_run(uint64_t *bytes_out)
{
	if (bytes_out == NULL) {
		return -EINVAL;
	}
	*bytes_out = 512ULL << 20;
	return 0;
}

/* The production one-pass directory read, over the fake directory table. */
int rdd2_flight_log_fs_scan(struct rdd2_flight_log_scan *out)
{
	if (out == NULL) {
		return -EINVAL;
	}
	if (!g_mounted) {
		return -ENODEV;
	}

	out->next_index = g_next_index;
	out->ready_count = 0U;
	out->ready_slot = -1;
	out->free_slot = -1;
	out->free_slot_used = false;

	for (uint32_t slot = 0U; slot < RDD2_FLIGHT_LOG_RESERVE_SLOTS; ++slot) {
		char name[32];
		const struct fake_file *f;

		reserve_name(slot, name, sizeof(name));
		f = fake_find(name);
		if (f != NULL && f->size == (uint64_t)CONFIG_RDD2_FLIGHT_LOG_ROTATE_BYTES) {
			out->ready_count++;
			if (out->ready_slot < 0) {
				out->ready_slot = (int)slot;
			}
		} else if (out->free_slot < 0) {
			out->free_slot = (int)slot;
			out->free_slot_used = f != NULL;
		}
	}
	return 0;
}

int rdd2_flight_log_fs_session_path(uint32_t index, char *out, size_t cap)
{
	int written;

	if (out == NULL) {
		return -EINVAL;
	}
	written = snprintk(out, cap, "%s/%s%04u%s", RDD2_FLIGHT_LOG_MOUNT_POINT,
			   RDD2_FLIGHT_LOG_FILE_PREFIX, (unsigned int)index,
			   RDD2_FLIGHT_LOG_FILE_SUFFIX);
	if (written < 0 || (size_t)written >= cap) {
		return -ENAMETOOLONG;
	}
	return written;
}

/* Raw fs entry points the logger calls directly. */

int fs_statvfs(const char *path, struct fs_statvfs *stat)
{
	ARG_UNUSED(path);
	if (stat == NULL) {
		return -EINVAL;
	}
	/* Roomy card: 512 MiB free against a scaled 256 KiB rotation size and a
	 * 1 MiB pool, so the session reservation keeps its full size and every pool
	 * build passes the free-space gate. */
	stat->f_bsize = 512U;
	stat->f_frsize = 512U;
	stat->f_blocks = 1U << 20;
	stat->f_bfree = 1U << 20;
	return 0;
}

int fs_unlink(const char *path)
{
	struct fake_file *f = fake_find(path);

	if (f == NULL) {
		return -ENOENT;
	}
	if (f == g_building) {
		g_building = NULL;
	}
	f->name[0] = '\0';
	return 0;
}

int fs_rename(const char *from, const char *to)
{
	struct fake_file *f = fake_find(from);

	ARG_UNUSED(to);
	if (f == NULL) {
		return -ENOENT;
	}
	/* Directory-entry-only move: the pre-built extent becomes the session, and
	 * session files are not modelled, so the entry simply goes away. */
	f->name[0] = '\0';
	g_next_index++;
	rdd2_test_rename_count++;
	return 0;
}

/* ---- fake MCAP sink / session stream ---- */

int mcap_stream_open_file(struct mcap_stream *stream, const char *path)
{
	ARG_UNUSED(path);
	if (stream == NULL) {
		return -EINVAL;
	}
	/* A new session file appears in the directory, so the next scan reports the
	 * following index. The rename path does the same in fs_rename. */
	g_next_index++;
	stream->file_open = true;
	stream->write_failed = false;
	stream->last_sync_ok = true;
	stream->preallocated = false;
	stream->reserved_bytes = 0U;
	stream->bytes_written = 0U;
	stream->block_fill = 0U;
	return 0;
}

int mcap_stream_preallocate(struct mcap_stream *stream, uint64_t size_bytes)
{
	if (stream == NULL || !stream->file_open || size_bytes == 0U) {
		return -EINVAL;
	}
	/* The inline f_expand burst: a multi-second allocation stall on the
	 * card. The writer holds the card lock across it; capture keeps
	 * enqueuing into the ring throughout. */
	if (rdd2_test_expand_stall_ms > 0U) {
		k_sleep(K_MSEC((int32_t)rdd2_test_expand_stall_ms));
	}
	rdd2_test_prealloc_count++;
	stream->preallocated = true;
	stream->reserved_bytes = size_bytes;
	return 0;
}

int mcap_stream_open_existing(struct mcap_stream *stream, const char *path, uint64_t reserved_bytes)
{
	ARG_UNUSED(path);
	if (stream == NULL) {
		return -EINVAL;
	}
	/* Reopen of a renamed pre-built extent: no reservation stall. */
	stream->file_open = true;
	stream->write_failed = false;
	stream->last_sync_ok = true;
	stream->preallocated = true;
	stream->reserved_bytes = reserved_bytes;
	stream->bytes_written = 0U;
	stream->block_fill = 0U;
	return 0;
}

static int mcap_stream_close_common(struct mcap_stream *stream)
{
	if (stream == NULL || !stream->file_open) {
		return 0;
	}
	stream->block_fill = 0U;
	stream->file_open = false;
	return 0;
}

int mcap_stream_close_file(struct mcap_stream *stream)
{
	return mcap_stream_close_common(stream);
}

int mcap_stream_close_file_full(struct mcap_stream *stream)
{
	return mcap_stream_close_common(stream);
}

int mcap_stream_sink_write(void *context, const uint8_t *data, size_t size)
{
	struct mcap_stream *stream = context;

	ARG_UNUSED(data);
	if (stream == NULL || !stream->file_open || stream->write_failed) {
		return -1;
	}
	stream->bytes_written += size;
	return 0;
}

int mcap_stream_sink_flush(void *context)
{
	struct mcap_stream *stream = context;

	if (stream == NULL || !stream->file_open || stream->write_failed) {
		if (stream != NULL) {
			stream->last_sync_ok = false;
		}
		return -1;
	}
	stream->last_sync_ok = true;
	return 0;
}

synapse_mcap_sink_t mcap_stream_sink(struct mcap_stream *stream)
{
	return (synapse_mcap_sink_t){
		.write = mcap_stream_sink_write,
		.flush = mcap_stream_sink_flush,
		.context = stream,
	};
}

void mcap_stream_session_id(char *out)
{
	if (out == NULL) {
		return;
	}
	memset(out, '0', RDD2_FLIGHT_LOG_SESSION_ID_LEN - 1U);
	out[RDD2_FLIGHT_LOG_SESSION_ID_LEN - 1U] = '\0';
}

int mcap_stream_reservation_open(struct prealloc_reservation *reservation, const char *path,
				 uint64_t target)
{
	struct fake_file *f;

	if (reservation == NULL || path == NULL || target == 0U) {
		return -EINVAL;
	}
	f = fake_find(path);
	if (f == NULL) {
		f = fake_create(path);
		if (f == NULL) {
			return -ENOSPC;
		}
	}
	f->size = 0U;
	g_building = f;
	reservation->open = true;
	reservation->reserved = 0U;
	reservation->target = target;
	return 0;
}

int mcap_stream_reservation_grow(struct prealloc_reservation *reservation, uint64_t step_bytes)
{
	if (reservation == NULL || !reservation->open || step_bytes == 0U ||
	    g_building == NULL) {
		return -EINVAL;
	}
	reservation->reserved += step_bytes;
	if (reservation->reserved >= reservation->target) {
		reservation->reserved = reservation->target;
		reservation->open = false;
		g_building->size = reservation->target;
		g_building = NULL;
		return 1;
	}
	g_building->size = reservation->reserved;
	return 0;
}

void mcap_stream_reservation_close(struct prealloc_reservation *reservation)
{
	if (reservation == NULL || !reservation->open) {
		return;
	}
	reservation->open = false;
}

/* ---- MCAP writer ---- */

int synapse_mcap_open(synapse_mcap_writer_t *writer, synapse_mcap_sink_t sink,
		      uint8_t *output_buffer, size_t output_buffer_size, const char *library,
		      const char *session_id, const char *source, int time_mode)
{
	ARG_UNUSED(output_buffer);
	ARG_UNUSED(output_buffer_size);
	ARG_UNUSED(library);
	ARG_UNUSED(session_id);
	ARG_UNUSED(source);
	ARG_UNUSED(time_mode);
	if (writer == NULL) {
		return -EINVAL;
	}
	writer->sink = sink;
	writer->sticky_error = SYNAPSE_MCAP_OK;
	writer->open = 1;
	return SYNAPSE_MCAP_OK;
}

int synapse_mcap_add_topic(synapse_mcap_writer_t *writer, const synapse_mcap_topic_t *topic,
			   const char *key, synapse_mcap_channel_t *channel)
{
	ARG_UNUSED(writer);
	ARG_UNUSED(key);
	if (topic == NULL || channel == NULL) {
		return -EINVAL;
	}
	channel->topic_id = topic->topic_id;
	channel->payload_size = topic->payload_size;
	channel->fixed_layout = topic->fixed_layout;
	return SYNAPSE_MCAP_OK;
}

int synapse_mcap_write_fixed(synapse_mcap_writer_t *writer, synapse_mcap_channel_t *channel,
			     uint64_t log_time_ns, uint64_t publish_time_ns, const void *payload,
			     size_t payload_size)
{
	ARG_UNUSED(channel);
	ARG_UNUSED(log_time_ns);
	ARG_UNUSED(publish_time_ns);
	ARG_UNUSED(payload);
	if (writer == NULL || !writer->open) {
		return -EINVAL;
	}
	/* Account the framed record through the sink so the session byte count
	 * that arms rotation reflects the real streamed volume. */
	(void)writer->sink.write(writer->sink.context, NULL,
				 payload_size + RDD2_FAKE_MCAP_RECORD_OVERHEAD);
	return SYNAPSE_MCAP_OK;
}

int synapse_mcap_flush(synapse_mcap_writer_t *writer)
{
	if (writer == NULL || !writer->open) {
		return -EINVAL;
	}
	return writer->sink.flush(writer->sink.context) == 0 ? SYNAPSE_MCAP_OK : -EIO;
}

int synapse_mcap_close(synapse_mcap_writer_t *writer)
{
	if (writer == NULL) {
		return -EINVAL;
	}
	writer->open = 0;
	return SYNAPSE_MCAP_OK;
}

int synapse_mcap_error(const synapse_mcap_writer_t *writer)
{
	if (writer == NULL) {
		return -EINVAL;
	}
	return writer->sticky_error;
}
```

## src/harness.h
```c
/* SPDX-License-Identifier: Apache-2.0 */

/*
 * Controls the flight-log rotation harness shares with the fake filesystem and
 * bus layer. The test body sets the injected card stall and pauses the offered
 * load to drive the idle-ring and manual-rotate cases.
 */

#ifndef RDD2_TEST_FLIGHT_LOG_ROTATION_HARNESS_H_
#define RDD2_TEST_FLIGHT_LOG_ROTATION_HARNESS_H_

#include <stdbool.h>
#include <stdint.h>

/* Milliseconds the fake inline extent reservation (f_expand) blocks the writer.
 * This is the mid-flight rotation burst the deferral change moves off the
 * rotation path. The spare-rename rotation path never incurs it. */
extern volatile uint32_t rdd2_test_expand_stall_ms;

/* When true the capture bus produces no samples, so the ring drains to idle. */
extern volatile bool rdd2_test_load_paused;

/* How many session extents each path has produced: the inline reservation
 * (f_expand) and the rename of a pre-built reservation. Their difference is how
 * the suite tells the two session-open paths apart. */
extern volatile uint32_t rdd2_test_prealloc_count;
extern volatile uint32_t rdd2_test_rename_count;

/* How many standing reservations of the full rotation size the fake card
 * currently carries, out of RDD2_FLIGHT_LOG_RESERVE_SLOTS. */
uint32_t rdd2_test_ready_reservations(void);

#endif /* RDD2_TEST_FLIGHT_LOG_ROTATION_HARNESS_H_ */
```
