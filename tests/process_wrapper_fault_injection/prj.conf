## CMakeLists.txt
```
# SPDX-License-Identifier: Apache-2.0

cmake_minimum_required(VERSION 3.20.0)

set(RDD2_TEST_EFMI_ROOT "" CACHE PATH
  "Root containing generated eFMI control directories"
)
if(NOT RDD2_TEST_EFMI_ROOT AND DEFINED ENV{RDD2_TEST_EFMI_ROOT})
  set(RDD2_TEST_EFMI_ROOT "$ENV{RDD2_TEST_EFMI_ROOT}")
endif()
if(NOT RDD2_TEST_EFMI_ROOT)
  message(FATAL_ERROR "RDD2_TEST_EFMI_ROOT is required")
endif()

get_filename_component(RDD2_TEST_EFMI_ROOT "${RDD2_TEST_EFMI_ROOT}" ABSOLUTE)
set(_rate_header
  "${RDD2_TEST_EFMI_ROOT}/Vehicles_Rdd2_RateControlAllocator/ProductionCode/Vehicles_Rdd2_RateControlAllocator.h"
)
set(_navigation_header
  "${RDD2_TEST_EFMI_ROOT}/Vehicles_Rdd2_NavigationEstimator/ProductionCode/Vehicles_Rdd2_NavigationEstimator.h"
)
set(_guidance_header
  "${RDD2_TEST_EFMI_ROOT}/Vehicles_Rdd2_GuidanceController/ProductionCode/Vehicles_Rdd2_GuidanceController.h"
)
get_filename_component(_rate_include_dir "${_rate_header}" DIRECTORY)
get_filename_component(_navigation_include_dir "${_navigation_header}" DIRECTORY)
get_filename_component(_guidance_include_dir "${_guidance_header}" DIRECTORY)
foreach(_generated_header IN ITEMS
    "${_rate_header}"
    "${_navigation_header}"
    "${_guidance_header}"
)
  if(NOT EXISTS "${_generated_header}")
    message(FATAL_ERROR "Missing generated header: ${_generated_header}")
  endif()
endforeach()

include("${CMAKE_CURRENT_LIST_DIR}/../rdd2_test_environment.cmake")

find_package(Zephyr REQUIRED HINTS $ENV{ZEPHYR_BASE})
project(process_wrapper_fault_injection)

target_include_directories(app PRIVATE
  "${RDD2_TEST_APP_ROOT}/src"
  "${RDD2_TEST_APP_ROOT}/src/processes"
  "${RDD2_TEST_APP_ROOT}/subsys/gnss_source"
  "${RDD2_TEST_APP_ROOT}/subsys/synapse_wire"
  "${RDD2_ZROS_ROOT}/include"
  "${_rate_include_dir}"
  "${_navigation_include_dir}"
  "${_guidance_include_dir}"
)
target_sources(app PRIVATE
  src/log_module.c
  src/rate_wrapper_test.c
  src/data_test.c
  src/imu_preintegration_test.c
  src/navigation_wrapper_test.c
  src/navigation_gps_test.c
  src/optical_flow_test.c
  src/optical_flow_raw_test.c
  src/guidance_wrapper_test.c
  "${RDD2_TEST_APP_ROOT}/src/processes/navigation_gps.c"
  "${RDD2_TEST_APP_ROOT}/src/processes/imu_preintegration.c"
  "${RDD2_TEST_APP_ROOT}/src/processes/navigation_optical_flow.c"
  "${RDD2_TEST_APP_ROOT}/src/processes/navigation_optical_flow_raw.c"
)
# The wrapper sources include interfaces/data.h and the optical-flow adapter
# includes the synapse readers, so the app needs the synapse_fbs C headers on
# its include path the same way the firmware image links them.
target_link_libraries(app PRIVATE synapse_fbs::c)
target_compile_definitions(app PRIVATE CONFIG_RDD2_LOCKSTEP=1)
```

## prj.conf
```kconfig
CONFIG_ZTEST=y
CONFIG_ASSERT=y
CONFIG_MAIN_THREAD_PRIORITY=2
```

## src/data_test.c
```c
/* SPDX-License-Identifier: Apache-2.0 */

#include <zephyr/ztest.h>

#include "../../../src/processes/scheduling.h"

#define rdd2_topic_make_control_loop_metrics data_test_make_control_loop_metrics
#define rdd2_topic_make_pwm_output data_test_make_pwm_output
#define rdd2_topic_make_vehicle_health data_test_make_vehicle_health

#include "../../../src/interfaces/data.c"

#undef rdd2_topic_make_vehicle_health
#undef rdd2_topic_make_pwm_output
#undef rdd2_topic_make_control_loop_metrics

ZTEST(process_wrapper_fault_injection,
      test_vehicle_health_reports_control_fault_latch) {
  rdd2_control_status_t status = {0};
  synapse_topic_VehicleHealthData_t health;

  data_test_make_vehicle_health(&health, &status);
  zexpect_equal(health.flags, 0U);

  status.failsafe = true;
  data_test_make_vehicle_health(&health, &status);
  zexpect_equal(health.flags, synapse_topic_VehicleHealthFlags_Failsafe);

  status.armed = true;
  data_test_make_vehicle_health(&health, &status);
  zexpect_equal(health.flags, synapse_topic_VehicleHealthFlags_Armed |
                                  synapse_topic_VehicleHealthFlags_Failsafe);

  status.failsafe = false;
  data_test_make_vehicle_health(&health, &status);
  zexpect_equal(health.flags, synapse_topic_VehicleHealthFlags_Armed);
}

ZTEST(process_wrapper_fault_injection,
      test_release_schedulers_preserve_exact_rates) {
  struct rdd2_release_scheduler navigation = {0};
  struct rdd2_release_scheduler guidance = {0};
  struct rdd2_release_scheduler planning = {0};
  uint32_t navigation_releases = 0U;
  uint32_t guidance_releases = 0U;
  uint32_t planning_releases = 0U;

  for (uint32_t sample = 0U; sample < RDD2_CONTROL_RATE_HZ; ++sample) {
    navigation_releases += rdd2_release_due(&navigation, RDD2_CONTROL_RATE_HZ,
                                            RDD2_NAVIGATION_ESTIMATOR_RATE_HZ)
                               ? 1U
                               : 0U;
  }
  /* Guidance and planning divide the CONTROL tick, not the estimator
   * publication: their rates must not move when the estimator rate does. */
  for (uint32_t sample = 0U; sample < RDD2_CONTROL_RATE_HZ; ++sample) {
    guidance_releases +=
        rdd2_release_due(&guidance, RDD2_CONTROL_RATE_HZ, RDD2_GUIDANCE_RATE_HZ)
            ? 1U
            : 0U;
    planning_releases +=
        rdd2_release_due(&planning, RDD2_CONTROL_RATE_HZ, RDD2_PLANNING_RATE_HZ)
            ? 1U
            : 0U;
  }

  zexpect_equal(navigation_releases, RDD2_NAVIGATION_ESTIMATOR_RATE_HZ);
  zexpect_equal(guidance_releases, RDD2_GUIDANCE_RATE_HZ);
  zexpect_equal(planning_releases, RDD2_PLANNING_RATE_HZ);
  zexpect_true(navigation.phase < RDD2_CONTROL_RATE_HZ);
  zexpect_true(guidance.phase < RDD2_CONTROL_RATE_HZ);
  zexpect_true(planning.phase < RDD2_CONTROL_RATE_HZ);
}
```

## src/imu_preintegration_test.c
```c
/* SPDX-License-Identifier: Apache-2.0 */

/*
 * The firmware preintegrator is a transcription of
 * Estimation.StrapdownINS.preintegrateImuStep, so it is checked the way the
 * model checks itself: the nominal composition against an independent
 * fine-grid integration of the same differential equation, and the bias
 * sensitivities against finite differences of the composition they linearize.
 * Neither reference reuses the closed form under test.
 */

#include "imu_preintegration.h"

#include <math.h>
#include <string.h>
#include <zephyr/ztest.h>

#define SAMPLE_DT_S 0.00125 /* 800 Hz */
#define PACKET_SAMPLES 8    /* 100 Hz packet */

static const float g_gyro[3] = {0.35f, -0.22f, 0.18f};
static const float g_accel[3] = {0.7f, -0.4f, 9.2f};
static const float g_zero[3] = {0.0f, 0.0f, 0.0f};

static void run_packet(struct rdd2_imu_packet *packet,
                       const float gyroscope_bias[3],
                       const float accelerometer_bias[3], bool first_order_hold) {
  struct rdd2_imu_preintegrator state;
  uint64_t timestamp_ns = UINT64_C(1000000000);
  const uint64_t step_ns = (uint64_t)(SAMPLE_DT_S * 1.0e9 + 0.5);

  memset(&state, 0, sizeof(state));
  state.first_order_hold = first_order_hold;
  rdd2_imu_preintegrator_reset(&state, gyroscope_bias, accelerometer_bias);
  /* Prime the sample history the way flight does, where it carries over from
   * the previous packet, so all PACKET_SAMPLES intervals are integrated. */
  (void)rdd2_imu_preintegrator_accumulate(&state, g_gyro, g_accel,
                                          timestamp_ns);
  for (int sample = 0; sample < PACKET_SAMPLES; ++sample) {
    timestamp_ns += step_ns;
    (void)rdd2_imu_preintegrator_accumulate(&state, g_gyro, g_accel,
                                            timestamp_ns);
  }
  rdd2_imu_preintegrator_close(&state, packet, timestamp_ns, gyroscope_bias,
                               accelerometer_bias);
}

/* Independent double-precision reference: dR/dt = R*wedge(w), dv/dt = R*a,
 * dp/dt = v, stepped far finer than the sample interval. */
static void reference_integrate(double total_time_s, long steps,
                                double position[3], double velocity[3],
                                double rotation[3][3]) {
  const double h = total_time_s / (double)steps;
  const double skew[3][3] = {
      {0.0, -(double)g_gyro[2], (double)g_gyro[1]},
      {(double)g_gyro[2], 0.0, -(double)g_gyro[0]},
      {-(double)g_gyro[1], (double)g_gyro[0], 0.0},
  };

  memset(position, 0, 3 * sizeof(double));
  memset(velocity, 0, 3 * sizeof(double));
  memset(rotation, 0, 9 * sizeof(double));
  rotation[0][0] = 1.0;
  rotation[1][1] = 1.0;
  rotation[2][2] = 1.0;
  for (long step = 0; step < steps; ++step) {
    double world_acceleration[3];
    double increment[3][3];
    double skew_squared[3][3];
    double updated[3][3];

    for (int row = 0; row < 3; ++row) {
      world_acceleration[row] = rotation[row][0] * (double)g_accel[0] +
                                rotation[row][1] * (double)g_accel[1] +
                                rotation[row][2] * (double)g_accel[2];
    }
    for (int row = 0; row < 3; ++row) {
      position[row] += velocity[row] * h + 0.5 * world_acceleration[row] * h * h;
      velocity[row] += world_acceleration[row] * h;
    }
    for (int row = 0; row < 3; ++row) {
      for (int column = 0; column < 3; ++column) {
        skew_squared[row][column] = 0.0;
        for (int inner = 0; inner < 3; ++inner) {
          skew_squared[row][column] += skew[row][inner] * skew[inner][column];
        }
      }
    }
    for (int row = 0; row < 3; ++row) {
      for (int column = 0; column < 3; ++column) {
        increment[row][column] = (row == column) ? 1.0 : 0.0;
        increment[row][column] +=
            skew[row][column] * h + 0.5 * skew_squared[row][column] * h * h;
      }
    }
    for (int row = 0; row < 3; ++row) {
      for (int column = 0; column < 3; ++column) {
        updated[row][column] = 0.0;
        for (int inner = 0; inner < 3; ++inner) {
          updated[row][column] +=
              rotation[row][inner] * increment[inner][column];
        }
      }
    }
    memcpy(rotation, updated, sizeof(updated));
  }
}

static void quaternion_to_rotation(double rotation[3][3],
                                   const float quaternion[4]) {
  const double a = quaternion[0];
  const double b = quaternion[1];
  const double c = quaternion[2];
  const double d = quaternion[3];

  rotation[0][0] = a * a + b * b - c * c - d * d;
  rotation[0][1] = 2.0 * (b * c - a * d);
  rotation[0][2] = 2.0 * (b * d + a * c);
  rotation[1][0] = 2.0 * (b * c + a * d);
  rotation[1][1] = a * a - b * b + c * c - d * d;
  rotation[1][2] = 2.0 * (c * d - a * b);
  rotation[2][0] = 2.0 * (b * d - a * c);
  rotation[2][1] = 2.0 * (c * d + a * b);
  rotation[2][2] = a * a - b * b - c * c + d * d;
}

ZTEST(process_wrapper_fault_injection,
      test_preintegration_matches_a_fine_grid_integration) {
  struct rdd2_imu_packet packet;
  double position[3];
  double velocity[3];
  double rotation[3][3];
  double packet_rotation[3][3];

  run_packet(&packet, g_zero, g_zero, false);
  reference_integrate(SAMPLE_DT_S * PACKET_SAMPLES, 200000, position, velocity,
                      rotation);

  zexpect_true(packet.valid);
  zexpect_within(packet.integration_time_s,
                 (float)(SAMPLE_DT_S * PACKET_SAMPLES), 1.0e-7f);
  zexpect_equal(packet.sample_count, (uint32_t)PACKET_SAMPLES);
  quaternion_to_rotation(packet_rotation, packet.delta_quaternion);
  for (int row = 0; row < 3; ++row) {
    zexpect_true(fabs((double)packet.delta_position_m[row] - position[row]) <
                 1.0e-7);
    zexpect_true(fabs((double)packet.delta_velocity_m_s[row] - velocity[row]) <
                 1.0e-4);
    /* The packet mean rate is what the block receives as
     * angularVelocityBodyFlu_rad_s; on a constant stream it is the input. */
    zexpect_within(packet.angular_velocity_rad_s[row], g_gyro[row], 1.0e-4f);
    for (int column = 0; column < 3; ++column) {
      zexpect_true(fabs(packet_rotation[row][column] -
                        rotation[row][column]) < 1.0e-5);
    }
  }
}

ZTEST(process_wrapper_fault_injection,
      test_first_order_hold_reduces_to_the_zero_order_hold_on_a_held_input) {
  struct rdd2_imu_packet zero_order;
  struct rdd2_imu_packet first_order;

  run_packet(&zero_order, g_zero, g_zero, false);
  run_packet(&first_order, g_zero, g_zero, true);
  for (int axis = 0; axis < 3; ++axis) {
    zexpect_within(first_order.delta_angle_rad[axis],
                   zero_order.delta_angle_rad[axis], 1.0e-6f);
    zexpect_within(first_order.delta_velocity_m_s[axis],
                   zero_order.delta_velocity_m_s[axis], 1.0e-6f);
  }
}

ZTEST(process_wrapper_fault_injection,
      test_bias_jacobians_match_finite_differences) {
  const double perturbation = 1.0e-4;
  struct rdd2_imu_packet nominal;

  run_packet(&nominal, g_zero, g_zero, false);
  for (int column = 0; column < 3; ++column) {
    struct rdd2_imu_packet perturbed;
    float anchor[3] = {0.0f, 0.0f, 0.0f};
    double nominal_rotation[3][3];
    double perturbed_rotation[3][3];
    double relative[3][3];
    double trace;
    double angle;
    double scale;
    double numeric[3];

    anchor[column] = (float)perturbation;
    run_packet(&perturbed, anchor, g_zero, false);
    quaternion_to_rotation(nominal_rotation, nominal.delta_quaternion);
    quaternion_to_rotation(perturbed_rotation, perturbed.delta_quaternion);
    for (int row = 0; row < 3; ++row) {
      for (int inner_column = 0; inner_column < 3; ++inner_column) {
        relative[row][inner_column] = 0.0;
        for (int inner = 0; inner < 3; ++inner) {
          relative[row][inner_column] +=
              nominal_rotation[inner][row] * perturbed_rotation[inner][inner_column];
        }
      }
    }
    trace = relative[0][0] + relative[1][1] + relative[2][2];
    angle = acos(fmin(1.0, fmax(-1.0, 0.5 * (trace - 1.0))));
    scale = (angle < 1.0e-9) ? 0.5 : angle / (2.0 * sin(angle));
    numeric[0] = scale * (relative[2][1] - relative[1][2]) / perturbation;
    numeric[1] = scale * (relative[0][2] - relative[2][0]) / perturbation;
    numeric[2] = scale * (relative[1][0] - relative[0][1]) / perturbation;
    for (int row = 0; row < 3; ++row) {
      zexpect_true(
          fabs(numeric[row] -
               (double)nominal.rotation_gyroscope_bias_jacobian_s[row][column]) <
          1.0e-3);
      zexpect_true(
          fabs(((double)perturbed.delta_velocity_m_s[row] -
                (double)nominal.delta_velocity_m_s[row]) / perturbation -
               (double)nominal.velocity_gyroscope_bias_jacobian_m[row][column]) <
          1.0e-2);
      zexpect_true(
          fabs(((double)perturbed.delta_position_m[row] -
                (double)nominal.delta_position_m[row]) / perturbation -
               (double)nominal.position_gyroscope_bias_jacobian_m_s[row][column]) <
          1.0e-4);
    }

    run_packet(&perturbed, g_zero, anchor, false);
    for (int row = 0; row < 3; ++row) {
      zexpect_true(
          fabs(((double)perturbed.delta_velocity_m_s[row] -
                (double)nominal.delta_velocity_m_s[row]) / perturbation -
               (double)
                   nominal.velocity_accelerometer_bias_jacobian_s[row][column]) <
          1.0e-3);
      zexpect_true(
          fabs(((double)perturbed.delta_position_m[row] -
                (double)nominal.delta_position_m[row]) / perturbation -
               (double)
                   nominal.position_accelerometer_bias_jacobian_s2[row][column]) <
          1.0e-4);
    }
  }
}

ZTEST(process_wrapper_fault_injection,
      test_packet_boundary_integrates_every_interval_exactly_once) {
  struct rdd2_imu_preintegrator state;
  struct rdd2_imu_packet first;
  struct rdd2_imu_packet second;
  uint64_t timestamp_ns = UINT64_C(5000000000);
  const uint64_t step_ns = (uint64_t)(SAMPLE_DT_S * 1.0e9 + 0.5);

  memset(&state, 0, sizeof(state));
  rdd2_imu_preintegrator_reset(&state, g_zero, g_zero);
  (void)rdd2_imu_preintegrator_accumulate(&state, g_gyro, g_accel,
                                          timestamp_ns);
  for (int sample = 0; sample < PACKET_SAMPLES; ++sample) {
    timestamp_ns += step_ns;
    (void)rdd2_imu_preintegrator_accumulate(&state, g_gyro, g_accel,
                                            timestamp_ns);
  }
  rdd2_imu_preintegrator_close(&state, &first, timestamp_ns, g_zero, g_zero);
  for (int sample = 0; sample < PACKET_SAMPLES; ++sample) {
    timestamp_ns += step_ns;
    (void)rdd2_imu_preintegrator_accumulate(&state, g_gyro, g_accel,
                                            timestamp_ns);
  }
  rdd2_imu_preintegrator_close(&state, &second, timestamp_ns, g_zero, g_zero);

  /* The interval spanning the boundary belongs to the second packet, so the
   * two windows tile the stream with no gap and no double count. */
  zexpect_equal(second.sample_count, (uint32_t)PACKET_SAMPLES);
  zexpect_within(first.integration_time_s + second.integration_time_s,
                 (float)(2.0 * SAMPLE_DT_S * PACKET_SAMPLES), 1.0e-6f);
}

ZTEST(process_wrapper_fault_injection,
      test_an_empty_window_produces_an_invalid_packet) {
  struct rdd2_imu_preintegrator state;
  struct rdd2_imu_packet packet;

  memset(&state, 0, sizeof(state));
  rdd2_imu_preintegrator_reset(&state, g_zero, g_zero);
  rdd2_imu_preintegrator_close(&state, &packet, UINT64_C(1000000000), g_zero,
                               g_zero);
  zexpect_false(packet.valid);
  zexpect_equal(packet.sample_count, 0U);
  zexpect_equal(packet.integration_time_s, 0.0f);
}

/* Integrate a run of gap_samples nominal intervals sample by sample, the way
 * an unbroken 800 Hz stream arrives. */
static void run_unbroken_stream(struct rdd2_imu_packet *packet, int gap_samples,
                                bool first_order_hold) {
  struct rdd2_imu_preintegrator state;
  uint64_t timestamp_ns = UINT64_C(2000000000);
  const uint64_t step_ns = (uint64_t)(SAMPLE_DT_S * 1.0e9 + 0.5);

  memset(&state, 0, sizeof(state));
  state.first_order_hold = first_order_hold;
  rdd2_imu_preintegrator_reset(&state, g_zero, g_zero);
  (void)rdd2_imu_preintegrator_accumulate(&state, g_gyro, g_accel,
                                          timestamp_ns);
  for (int sample = 0; sample < gap_samples; ++sample) {
    timestamp_ns += step_ns;
    (void)rdd2_imu_preintegrator_accumulate(&state, g_gyro, g_accel,
                                            timestamp_ns);
  }
  rdd2_imu_preintegrator_close(&state, packet, timestamp_ns, g_zero, g_zero);
}

/* Deliver the same span as a single sample after a gap of gap_samples nominal
 * periods, so the interval is bridged rather than integrated directly. */
static void run_bridged_gap(struct rdd2_imu_preintegrator *state,
                            struct rdd2_imu_packet *packet, int gap_samples,
                            bool first_order_hold) {
  uint64_t timestamp_ns = UINT64_C(2000000000);
  const uint64_t step_ns = (uint64_t)(SAMPLE_DT_S * 1.0e9 + 0.5);

  memset(state, 0, sizeof(*state));
  state->first_order_hold = first_order_hold;
  rdd2_imu_preintegrator_reset(state, g_zero, g_zero);
  (void)rdd2_imu_preintegrator_accumulate(state, g_gyro, g_accel, timestamp_ns);
  /* The nominal period sizes the reconstructed sub-intervals; setting it after
   * the priming sample keeps that sample history-only. */
  state->nominal_sample_period_s = (float)SAMPLE_DT_S;
  timestamp_ns += (uint64_t)gap_samples * step_ns;
  (void)rdd2_imu_preintegrator_accumulate(state, g_gyro, g_accel, timestamp_ns);
  rdd2_imu_preintegrator_close(state, packet, timestamp_ns, g_zero, g_zero);
}

ZTEST(process_wrapper_fault_injection,
      test_a_bridged_gap_matches_the_unbroken_stream_at_constant_rate) {
  const int gap_samples = 80; /* 100 ms at 800 Hz */
  struct rdd2_imu_preintegrator bridged_state;
  struct rdd2_imu_packet unbroken;
  struct rdd2_imu_packet bridged;

  run_unbroken_stream(&unbroken, gap_samples, false);
  run_bridged_gap(&bridged_state, &bridged, gap_samples, false);

  zexpect_true(bridged.valid);
  zexpect_within(bridged.integration_time_s, unbroken.integration_time_s,
                 1.0e-5f);
  for (int axis = 0; axis < 3; ++axis) {
    zexpect_within(bridged.delta_angle_rad[axis], unbroken.delta_angle_rad[axis],
                   1.0e-5f);
    zexpect_within(bridged.delta_velocity_m_s[axis],
                   unbroken.delta_velocity_m_s[axis], 1.0e-4f);
    zexpect_within(bridged.delta_position_m[axis], unbroken.delta_position_m[axis],
                   1.0e-4f);
  }
}

ZTEST(process_wrapper_fault_injection,
      test_a_bridged_gap_matches_the_unbroken_stream_under_first_order_hold) {
  const int gap_samples = 80;
  struct rdd2_imu_preintegrator bridged_state;
  struct rdd2_imu_packet unbroken;
  struct rdd2_imu_packet bridged;

  run_unbroken_stream(&unbroken, gap_samples, true);
  run_bridged_gap(&bridged_state, &bridged, gap_samples, true);

  zexpect_true(bridged.valid);
  for (int axis = 0; axis < 3; ++axis) {
    zexpect_within(bridged.delta_angle_rad[axis], unbroken.delta_angle_rad[axis],
                   1.0e-5f);
    zexpect_within(bridged.delta_velocity_m_s[axis],
                   unbroken.delta_velocity_m_s[axis], 1.0e-4f);
  }
}

ZTEST(process_wrapper_fault_injection,
      test_a_gap_beyond_the_bridge_bound_is_rejected) {
  struct rdd2_imu_preintegrator state;
  struct rdd2_imu_packet packet;
  uint64_t timestamp_ns = UINT64_C(3000000000);

  memset(&state, 0, sizeof(state));
  rdd2_imu_preintegrator_reset(&state, g_zero, g_zero);
  (void)rdd2_imu_preintegrator_accumulate(&state, g_gyro, g_accel,
                                          timestamp_ns);
  state.nominal_sample_period_s = (float)SAMPLE_DT_S;
  /* 300 ms exceeds RDD2_IMU_PREINTEGRATION_MAX_BRIDGE_DT_S. */
  timestamp_ns += (uint64_t)(0.3 * 1.0e9);
  {
    bool integrated = rdd2_imu_preintegrator_accumulate(&state, g_gyro, g_accel,
                                                        timestamp_ns);
    zexpect_false(integrated);
  }
  rdd2_imu_preintegrator_close(&state, &packet, timestamp_ns, g_zero, g_zero);

  zexpect_false(packet.valid);
  zexpect_equal(state.rejected_sample_count, 1U);
  zexpect_equal(state.bridged_sample_count, 0U);
  zexpect_equal(packet.sample_count, 0U);
}

ZTEST(process_wrapper_fault_injection, test_bridge_counters_behave) {
  struct rdd2_imu_preintegrator state;
  struct rdd2_imu_packet packet;
  uint64_t timestamp_ns = UINT64_C(4000000000);
  const uint64_t step_ns = (uint64_t)(SAMPLE_DT_S * 1.0e9 + 0.5);

  memset(&state, 0, sizeof(state));
  rdd2_imu_preintegrator_reset(&state, g_zero, g_zero);
  zexpect_equal(state.bridged_sample_count, 0U);
  (void)rdd2_imu_preintegrator_accumulate(&state, g_gyro, g_accel,
                                          timestamp_ns);
  state.nominal_sample_period_s = (float)SAMPLE_DT_S;

  /* One normal interval, then one bridged gap, then another normal interval. */
  timestamp_ns += step_ns;
  (void)rdd2_imu_preintegrator_accumulate(&state, g_gyro, g_accel,
                                          timestamp_ns);
  timestamp_ns += (uint64_t)(0.1 * 1.0e9); /* 100 ms bridge */
  (void)rdd2_imu_preintegrator_accumulate(&state, g_gyro, g_accel,
                                          timestamp_ns);
  timestamp_ns += step_ns;
  (void)rdd2_imu_preintegrator_accumulate(&state, g_gyro, g_accel,
                                          timestamp_ns);

  zexpect_equal(state.bridged_sample_count, 1U);
  zexpect_equal(state.rejected_sample_count, 0U);
  /* Two normal samples plus the one bridging sample each advance the count. */
  zexpect_equal(state.sample_count, 3U);

  rdd2_imu_preintegrator_close(&state, &packet, timestamp_ns, g_zero, g_zero);
  zexpect_true(packet.valid);
  /* The window spans two nominal intervals plus the 100 ms bridge. */
  zexpect_within(packet.integration_time_s,
                 (float)(2.0 * SAMPLE_DT_S + 0.1), 1.0e-5f);
  /* Restart clears the window counters but preserves the fault tallies. */
  zexpect_equal(state.bridged_sample_count, 1U);
}
```

## src/optical_flow_raw_test.c
```c
/* SPDX-License-Identifier: Apache-2.0 */

/*
 * Tightly coupled optical-flow adapter tests.
 *
 * These pin the sign convention that bridges the flow node's OpticalFlowData to
 * the ESKF OpticalFlowSample, the rejection statuses, the covariance scaling
 * and the mount-yaw rotation. The convention (see navigation_optical_flow_raw.h)
 * is line-of-sight = mount_yaw(flow_rad) and integrated gyro =
 * -mount_yaw(delta_angle_flu), so the estimator's compensatedFlow =
 * line_of_sight + gyro reproduces the node's flow_rad - delta_angle_flu.
 */

#include "processes/navigation_optical_flow_raw.h"

#include <math.h>
#include <string.h>
#include <zephyr/ztest.h>

#define TEST_MS_TO_NS(value) ((uint64_t)(value) * UINT64_C(1000000))
#define GYRO_ND 3800.0e-6f
#define LOS_FLOOR 300.0e-6f
#define LOS_BEST 0.05f
#define LOS_WORST 0.25f

static const struct rdd2_navigation_optical_flow_raw_config g_config = {
    .max_age_ns = TEST_MS_TO_NS(150),
    .min_distance_m = 0.05f,
    .max_distance_m = 5.0f,
    .min_integration_time_s = 0.005f,
    .max_integration_time_s = 0.200f,
    .los_floor_rad = LOS_FLOOR,
    .los_sens_best_frac = LOS_BEST,
    .los_sens_worst_frac = LOS_WORST,
    .gyro_rate_noise_rad_s_rthz = GYRO_ND,
    .range_best_stddev_m = 0.03f,
    .range_worst_stddev_m = 0.15f,
    .mount_yaw_deg = 0,
    .sensor_id = 0,
    .min_quality = 100,
    .require_gptp = true,
};

static synapse_topic_OpticalFlowData_t
raw_sample(uint64_t timestamp_ns, float fx, float fy, float dx, float dy,
           float dz, float distance_m, uint32_t integration_ns) {
  synapse_topic_OpticalFlowData_t sample;

  memset(&sample, 0, sizeof(sample));
  sample.timestamp_ns = timestamp_ns;
  sample.flow_rad.x = fx;
  sample.flow_rad.y = fy;
  sample.delta_angle_flu_rad.x = dx;
  sample.delta_angle_flu_rad.y = dy;
  sample.delta_angle_flu_rad.z = dz;
  sample.distance_m = distance_m;
  sample.integration_timespan_ns = integration_ns;
  sample.quality = 200;
  sample.distance_quality = 200;
  sample.flags = RDD2_OPTICAL_FLOW_RAW_FLOW_VALID |
                 RDD2_OPTICAL_FLOW_RAW_DELTA_ANGLE_VALID |
                 RDD2_OPTICAL_FLOW_RAW_DISTANCE_VALID;
  sample.time_status = synapse_types_TimeStatus_GptpSynced;
  sample.id = 0;
  return sample;
}

static void step_once(struct rdd2_navigation_optical_flow_raw_adapter *adapter,
                      struct rdd2_navigation_optical_flow_raw_measurement *out,
                      const synapse_topic_OpticalFlowData_t *sample) {
  rdd2_navigation_optical_flow_raw_step(adapter, out, sample, true,
                                        sample->timestamp_ns, &g_config);
}

/* A pure-translation window (zero delta angle) leaves the line-of-sight equal
 * to the flow and the gyro term zero; forward motion (flow y > 0) gives a
 * positive line-of-sight y, which the estimator scales into forward velocity. */
ZTEST(process_wrapper_fault_injection, test_optical_flow_raw_pure_translation) {
  struct rdd2_navigation_optical_flow_raw_adapter adapter;
  struct rdd2_navigation_optical_flow_raw_measurement m;
  synapse_topic_OpticalFlowData_t sample = raw_sample(
      TEST_MS_TO_NS(1000), 0.01f, 0.02f, 0.0f, 0.0f, 0.0f, 2.0f, 25000000U);

  rdd2_navigation_optical_flow_raw_init(&adapter);
  step_once(&adapter, &m, &sample);

  zassert_true(m.valid, "translation window should be accepted");
  zassert_true(m.fresh, "fresh sample");
  zassert_equal(adapter.status, RDD2_OPTICAL_FLOW_RAW_ACCEPTED, "status %d",
                adapter.status);
  zassert_within(m.integrated_line_of_sight_rad[0], 0.01f, 1.0e-6f, "los x");
  zassert_within(m.integrated_line_of_sight_rad[1], 0.02f, 1.0e-6f, "los y");
  zassert_within(m.integrated_gyro_body_flu_rad[0], 0.0f, 1.0e-9f, "gyro x");
  zassert_within(m.integrated_gyro_body_flu_rad[1], 0.0f, 1.0e-9f, "gyro y");
  zassert_true(m.integrated_line_of_sight_rad[1] > 0.0f,
               "forward motion gives positive line-of-sight y");
  zassert_within(m.integration_time_s, 0.025f, 1.0e-6f, "dt");
}

/* A pure-rotation window has flow equal to the co-timed body rotation, so the
 * estimator's compensated flow (line_of_sight + gyro) cancels to zero. */
ZTEST(process_wrapper_fault_injection, test_optical_flow_raw_pure_rotation) {
  struct rdd2_navigation_optical_flow_raw_adapter adapter;
  struct rdd2_navigation_optical_flow_raw_measurement m;
  synapse_topic_OpticalFlowData_t sample = raw_sample(
      TEST_MS_TO_NS(1000), 0.03f, -0.02f, 0.03f, -0.02f, 0.01f, 2.0f,
      25000000U);

  rdd2_navigation_optical_flow_raw_init(&adapter);
  step_once(&adapter, &m, &sample);

  zassert_true(m.valid, "rotation window should be accepted");
  zassert_within(m.integrated_line_of_sight_rad[0] +
                     m.integrated_gyro_body_flu_rad[0],
                 0.0f, 1.0e-6f, "compensated x cancels");
  zassert_within(m.integrated_line_of_sight_rad[1] +
                     m.integrated_gyro_body_flu_rad[1],
                 0.0f, 1.0e-6f, "compensated y cancels");
  /* the reported gyro is the negated body-angle integral */
  zassert_within(m.integrated_gyro_body_flu_rad[2], -0.01f, 1.0e-6f, "gyro z");
}

/* Mount yaw rotates both the flow and the delta before the gyro is negated. */
ZTEST(process_wrapper_fault_injection, test_optical_flow_raw_mount_yaw_90) {
  struct rdd2_navigation_optical_flow_raw_adapter adapter;
  struct rdd2_navigation_optical_flow_raw_measurement m;
  struct rdd2_navigation_optical_flow_raw_config cfg = g_config;
  synapse_topic_OpticalFlowData_t sample = raw_sample(
      TEST_MS_TO_NS(1000), 0.01f, 0.02f, 0.005f, 0.0f, 0.0f, 2.0f, 25000000U);

  cfg.mount_yaw_deg = 90;
  rdd2_navigation_optical_flow_raw_init(&adapter);
  rdd2_navigation_optical_flow_raw_step(&adapter, &m, &sample, true,
                                        sample.timestamp_ns, &cfg);

  zassert_true(m.valid, "accepted");
  /* Rz(90): x' = -y, y' = x */
  zassert_within(m.integrated_line_of_sight_rad[0], -0.02f, 1.0e-6f, "los x");
  zassert_within(m.integrated_line_of_sight_rad[1], 0.01f, 1.0e-6f, "los y");
  /* delta (0.005, 0) rotates to (0, 0.005), then negated */
  zassert_within(m.integrated_gyro_body_flu_rad[0], 0.0f, 1.0e-6f, "gyro x");
  zassert_within(m.integrated_gyro_body_flu_rad[1], -0.005f, 1.0e-6f, "gyro y");
}

/* Line-of-sight variance is (floor + sensitivity * |angle|)^2 with the
 * sensitivity interpolated by quality; gyro variance is density^2 * window;
 * range variance is the quality-interpolated range stddev squared. */
ZTEST(process_wrapper_fault_injection, test_optical_flow_raw_covariance) {
  struct rdd2_navigation_optical_flow_raw_adapter adapter;
  struct rdd2_navigation_optical_flow_raw_measurement m;
  synapse_topic_OpticalFlowData_t sample = raw_sample(
      TEST_MS_TO_NS(1000), 0.01f, 0.02f, 0.0f, 0.0f, 0.0f, 2.0f, 25000000U);
  float norm_q = (200.0f - 100.0f) / (255.0f - 100.0f);
  float sens = LOS_WORST - norm_q * (LOS_WORST - LOS_BEST);
  float sigma0 = LOS_FLOOR + sens * 0.01f;
  float sigma1 = LOS_FLOOR + sens * 0.02f;
  float gyro_var = GYRO_ND * GYRO_ND * 0.025f;
  float norm_dq = 200.0f / 255.0f;
  float range_stddev = 0.15f - norm_dq * (0.15f - 0.03f);

  rdd2_navigation_optical_flow_raw_init(&adapter);
  step_once(&adapter, &m, &sample);

  zassert_within(m.integrated_line_of_sight_cov_rad2[0][0], sigma0 * sigma0,
                 1.0e-9f, "los var x");
  zassert_within(m.integrated_line_of_sight_cov_rad2[1][1], sigma1 * sigma1,
                 1.0e-9f, "los var y");
  zassert_within(m.integrated_line_of_sight_cov_rad2[0][1], 0.0f, 1.0e-12f,
                 "los cov off-diagonal");
  zassert_within(m.integrated_gyro_cov_rad2[0][0], gyro_var, 1.0e-12f,
                 "gyro var x");
  zassert_within(m.integrated_gyro_cov_rad2[2][2], gyro_var, 1.0e-12f,
                 "gyro var z");
  zassert_within(m.ground_distance_variance_m2, range_stddev * range_stddev,
                 1.0e-9f, "range var");
}

static void expect_reject(synapse_topic_OpticalFlowData_t *sample,
                          enum rdd2_navigation_optical_flow_raw_status expected) {
  struct rdd2_navigation_optical_flow_raw_adapter adapter;
  struct rdd2_navigation_optical_flow_raw_measurement m;

  rdd2_navigation_optical_flow_raw_init(&adapter);
  step_once(&adapter, &m, sample);
  zassert_false(m.valid, "rejected sample must not be valid");
  zassert_equal(adapter.status, expected, "status %d expected %d",
                adapter.status, expected);
  zassert_equal(adapter.rejected_count, 1U, "one rejection counted");
}

ZTEST(process_wrapper_fault_injection, test_optical_flow_raw_rejections) {
  synapse_topic_OpticalFlowData_t s;

  s = raw_sample(TEST_MS_TO_NS(1000), 0.01f, 0.0f, 0.0f, 0.0f, 0.0f, 2.0f,
                 25000000U);
  s.timestamp_ns = 0U;
  expect_reject(&s, RDD2_OPTICAL_FLOW_RAW_REJECTED_ZERO_TIMESTAMP);

  s = raw_sample(TEST_MS_TO_NS(1000), 0.01f, 0.0f, 0.0f, 0.0f, 0.0f, 2.0f,
                 25000000U);
  s.id = 3U;
  expect_reject(&s, RDD2_OPTICAL_FLOW_RAW_REJECTED_SENSOR_ID);

  s = raw_sample(TEST_MS_TO_NS(1000), 0.01f, 0.0f, 0.0f, 0.0f, 0.0f, 2.0f,
                 25000000U);
  s.flags &= (uint8_t)~RDD2_OPTICAL_FLOW_RAW_FLOW_VALID;
  expect_reject(&s, RDD2_OPTICAL_FLOW_RAW_REJECTED_FLOW_INVALID);

  s = raw_sample(TEST_MS_TO_NS(1000), 0.01f, 0.0f, 0.0f, 0.0f, 0.0f, 2.0f,
                 25000000U);
  s.flags &= (uint8_t)~RDD2_OPTICAL_FLOW_RAW_DELTA_ANGLE_VALID;
  expect_reject(&s, RDD2_OPTICAL_FLOW_RAW_REJECTED_DELTA_ANGLE_INVALID);

  s = raw_sample(TEST_MS_TO_NS(1000), 0.01f, 0.0f, 0.0f, 0.0f, 0.0f, 2.0f,
                 25000000U);
  s.flags &= (uint8_t)~RDD2_OPTICAL_FLOW_RAW_DISTANCE_VALID;
  expect_reject(&s, RDD2_OPTICAL_FLOW_RAW_REJECTED_DISTANCE_INVALID);

  s = raw_sample(TEST_MS_TO_NS(1000), 0.01f, 0.0f, 0.0f, 0.0f, 0.0f, 2.0f,
                 25000000U);
  s.flags |= RDD2_OPTICAL_FLOW_RAW_DISTANCE_AMBIGUOUS;
  expect_reject(&s, RDD2_OPTICAL_FLOW_RAW_REJECTED_DISTANCE_AMBIGUOUS);

  s = raw_sample(TEST_MS_TO_NS(1000), 0.01f, 0.0f, 0.0f, 0.0f, 0.0f, 2.0f,
                 25000000U);
  s.quality = 50U;
  expect_reject(&s, RDD2_OPTICAL_FLOW_RAW_REJECTED_QUALITY);

  s = raw_sample(TEST_MS_TO_NS(1000), 0.01f, 0.0f, 0.0f, 0.0f, 0.0f, 2.0f,
                 25000000U);
  s.time_status = synapse_types_TimeStatus_LocalFreerun;
  expect_reject(&s, RDD2_OPTICAL_FLOW_RAW_REJECTED_TIME_STATUS);

  s = raw_sample(TEST_MS_TO_NS(1000), 0.01f, 0.0f, 0.0f, 0.0f, 0.0f, 10.0f,
                 25000000U);
  expect_reject(&s, RDD2_OPTICAL_FLOW_RAW_REJECTED_DISTANCE);

  s = raw_sample(TEST_MS_TO_NS(1000), 0.01f, 0.0f, 0.0f, 0.0f, 0.0f, 2.0f,
                 1000000U);
  expect_reject(&s, RDD2_OPTICAL_FLOW_RAW_REJECTED_INTEGRATION_TIME);

  s = raw_sample(TEST_MS_TO_NS(1000), NAN, 0.0f, 0.0f, 0.0f, 0.0f, 2.0f,
                 25000000U);
  expect_reject(&s, RDD2_OPTICAL_FLOW_RAW_REJECTED_NONFINITE);
}

/* A non-increasing source timestamp is a replay and is rejected. */
ZTEST(process_wrapper_fault_injection, test_optical_flow_raw_replay) {
  struct rdd2_navigation_optical_flow_raw_adapter adapter;
  struct rdd2_navigation_optical_flow_raw_measurement m;
  synapse_topic_OpticalFlowData_t first = raw_sample(
      TEST_MS_TO_NS(1000), 0.01f, 0.0f, 0.0f, 0.0f, 0.0f, 2.0f, 25000000U);
  synapse_topic_OpticalFlowData_t replay = raw_sample(
      TEST_MS_TO_NS(1000), 0.02f, 0.0f, 0.0f, 0.0f, 0.0f, 2.0f, 25000000U);

  rdd2_navigation_optical_flow_raw_init(&adapter);
  step_once(&adapter, &m, &first);
  zassert_true(m.valid, "first accepted");
  rdd2_navigation_optical_flow_raw_step(&adapter, &m, &replay, true,
                                        TEST_MS_TO_NS(1000), &g_config);
  zassert_equal(adapter.status, RDD2_OPTICAL_FLOW_RAW_REJECTED_REPLAY,
                "status %d", adapter.status);
}
```

## src/optical_flow_test.c
```c
/* SPDX-License-Identifier: Apache-2.0 */

#include "processes/navigation_optical_flow.h"

#include <math.h>
#include <string.h>
#include <zephyr/ztest.h>

#define TEST_MS_TO_NS(value) ((uint64_t)(value) * UINT64_C(1000000))

static const struct rdd2_navigation_optical_flow_config g_config = {
    .max_age_ns = TEST_MS_TO_NS(150),
    .min_distance_m = 0.05f,
    .max_distance_m = 5.0f,
    .max_tilt_rad = 0.7f,
    .max_speed_m_s = 10.0f,
    .best_stddev_m_s = 0.1f,
    .worst_stddev_m_s = 1.0f,
    .range_variance_m2 = 0.05f * 0.05f,
    .nominal_integration_time_s = 0.025f,
    .min_integration_time_s = 0.005f,
    .max_integration_time_s = 0.200f,
    .sensor_id = 0,
    .min_quality = 100,
    .require_gptp = true,
};

static synapse_topic_OpticalFlowVelocityData_t
valid_sample(uint64_t timestamp_ns, float vx, float vy, float distance_m) {
  synapse_topic_OpticalFlowVelocityData_t sample;
  memset(&sample, 0, sizeof(sample));
  sample.timestamp_ns = timestamp_ns;
  sample.velocity_flu_m_s.x = vx;
  sample.velocity_flu_m_s.y = vy;
  sample.distance_m = distance_m;
  sample.roll_rad = 0.0f;
  sample.pitch_rad = 0.0f;
  sample.quality = 200;
  sample.flags = RDD2_OPTICAL_FLOW_VELOCITY_VALID |
                 RDD2_OPTICAL_FLOW_TILT_COMPENSATED |
                 RDD2_OPTICAL_FLOW_RANGE_TRUSTED;
  sample.time_status = synapse_types_TimeStatus_GptpSynced;
  sample.id = 0;
  return sample;
}

/* The adapter derives the exposure window from the interval between accepted
 * source timestamps: the first accepted sample uses the nominal period and
 * subsequent samples use the measured gap. The line-of-sight the estimator
 * forms from this measurement then has magnitude v * dt / range. */
ZTEST(process_wrapper_fault_injection,
      test_optical_flow_integration_time_from_interval) {
  struct rdd2_navigation_optical_flow_adapter adapter;
  struct rdd2_navigation_optical_flow_measurement measurement;
  const float vx = 1.0f;
  const float vy = 0.5f;
  const float range_m = 2.0f;
  uint64_t t0 = TEST_MS_TO_NS(1000);

  rdd2_navigation_optical_flow_init(&adapter);

  /* First accepted sample after init falls back to the nominal period. */
  synapse_topic_OpticalFlowVelocityData_t s0 =
      valid_sample(t0, vx, vy, range_m);
  rdd2_navigation_optical_flow_step(&adapter, &measurement, &s0, true, t0,
                                    &g_config);
  zexpect_equal(adapter.status, RDD2_OPTICAL_FLOW_ACCEPTED);
  zexpect_true(measurement.valid);
  zexpect_within(measurement.integration_time_s, 0.025f, 1.0e-6f);

  /* Second accepted sample 25 ms later yields integration_time_s = 0.025. */
  uint64_t t1 = t0 + TEST_MS_TO_NS(25);
  synapse_topic_OpticalFlowVelocityData_t s1 =
      valid_sample(t1, vx, vy, range_m);
  rdd2_navigation_optical_flow_step(&adapter, &measurement, &s1, true, t1,
                                    &g_config);
  zexpect_equal(adapter.status, RDD2_OPTICAL_FLOW_ACCEPTED);
  zexpect_true(measurement.fresh);
  zexpect_within(measurement.integration_time_s, 0.025f, 1.0e-6f);

  /* The estimator scales velocity into a line-of-sight angle by
   * integration_time / range, so |line-of-sight| = |v| * dt / range. */
  float k = measurement.integration_time_s / measurement.ground_distance_m;
  float los0 = -measurement.velocity_body_flu_m_s[1] * k;
  float los1 = measurement.velocity_body_flu_m_s[0] * k;
  float los_mag = sqrtf(los0 * los0 + los1 * los1);
  float expected_mag = sqrtf(vx * vx + vy * vy) * 0.025f / range_m;
  zexpect_within(los_mag, expected_mag, 1.0e-6f);

  /* A different measured interval flows through unchanged, proving the value
   * tracks the source cadence rather than the nominal period. */
  uint64_t t2 = t1 + TEST_MS_TO_NS(40);
  synapse_topic_OpticalFlowVelocityData_t s2 =
      valid_sample(t2, vx, vy, range_m);
  rdd2_navigation_optical_flow_step(&adapter, &measurement, &s2, true, t2,
                                    &g_config);
  zexpect_equal(adapter.status, RDD2_OPTICAL_FLOW_ACCEPTED);
  zexpect_within(measurement.integration_time_s, 0.040f, 1.0e-6f);
}

/* An interval far above the plausible exposure window is a dropout, not an
 * exposure, so the sample is rejected with a named status and counted. */
ZTEST(process_wrapper_fault_injection,
      test_optical_flow_rejects_long_integration_interval) {
  struct rdd2_navigation_optical_flow_adapter adapter;
  struct rdd2_navigation_optical_flow_measurement measurement;
  const float range_m = 2.0f;
  uint64_t t0 = TEST_MS_TO_NS(1000);

  rdd2_navigation_optical_flow_init(&adapter);

  synapse_topic_OpticalFlowVelocityData_t s0 =
      valid_sample(t0, 1.0f, 0.5f, range_m);
  rdd2_navigation_optical_flow_step(&adapter, &measurement, &s0, true, t0,
                                    &g_config);
  zexpect_equal(adapter.status, RDD2_OPTICAL_FLOW_ACCEPTED);
  uint32_t rejected_before = adapter.rejected_count;

  /* 500 ms after the previous accepted sample exceeds the 200 ms bound. */
  uint64_t t1 = t0 + TEST_MS_TO_NS(500);
  synapse_topic_OpticalFlowVelocityData_t s1 =
      valid_sample(t1, 1.0f, 0.5f, range_m);
  rdd2_navigation_optical_flow_step(&adapter, &measurement, &s1, true, t1,
                                    &g_config);
  zexpect_equal(adapter.status, RDD2_OPTICAL_FLOW_REJECTED_INTEGRATION_TIME);
  zexpect_false(measurement.valid);
  zexpect_equal(adapter.rejected_count, rejected_before + 1U);
  zassert_equal(strcmp(rdd2_navigation_optical_flow_status_name(
                           RDD2_OPTICAL_FLOW_REJECTED_INTEGRATION_TIME),
                       "integration-time"),
                0);
}
```
